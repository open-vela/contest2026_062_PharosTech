## app/nyabula_core/Kconfig
```kconfig
#
# SPDX-License-Identifier: Apache-2.0
#
# Licensed to the Apache Software Foundation (ASF) under one or more contributor
# license agreements.  See the NOTICE file distributed with this work for
# additional information regarding copyright ownership.  The ASF licenses this
# file to you under the Apache License, Version 2.0 (the "License"); you may not
# use this file except in compliance with the License.  You may obtain a copy of
# the License at
#
#   http://www.apache.org/licenses/LICENSE-2.0
#
# Unless required by applicable law or agreed to in writing, software
# distributed under the License is distributed on an "AS IS" BASIS, WITHOUT
# WARRANTIES OR CONDITIONS OF ANY KIND, either express or implied.  See the
# License for the specific language governing permissions and limitations under
# the License.
#
# For a description of the syntax of this configuration file,
# see the kconfig-language.txt file in the NuttX tools repository.
#

config CONTEST2026_062_NYABULA_CORE
	bool "Nyabula Core plugin launcher"
	default n
	select ALLOW_ICS_COMPONENTS
	select INTERPRETERS_QUICKJS
	select NETUTILS_CJSON
	---help---
		Enable the Nyabula Core plugin launcher and its isolated QuickJS
		runtime.

if CONTEST2026_062_NYABULA_CORE

config NYABULA_CORE_AGENT
	bool "Nyabot official ai_agent adapter"
	default n
	depends on NYABULA_CORE_PRODUCT && EXAMPLES_AI_AGENT_VELA
	select LIBSODIUM
	---help---
		Use the official ai_agent loop with Core-owned run records and
		owner-only requests. Standalone channels are not started here.

config NYABULA_CORE_EYE
	bool "Connect UI capabilities to Nyabula Eye Engine"
	default n
	depends on NYABULA_EYE_ENGINE && !BUILD_KERNEL
	---help---
		ui.notify displays a caption and ui.eye submits the Eye command
		contract. Requires an attached LVGL display owner.

config NYABULA_CORE_WEATHER
	bool "Core QWeather service"
	default y if NYABULA_CORE_AGENT
	depends on NYABULA_CORE_AGENT
	---help---
		Run configurable weather polling with verified HTTPS, bounded JSON
		responses and persistent alert deduplication. No bundled credentials.

config NYABULA_CORE_WAMR
	bool "Enable WAMR plugin runtime"
	default y
	select INTERPRETERS_WAMR
	select INTERPRETERS_WAMR_THREAD_MGR

config NYABULA_CORE_WEB
	bool "Core WebSocket service"
	default n
	depends on NYABULA_CORE_EYE && NET_TCP && NET_IPv4 && !BUILD_KERNEL
	select NET_SOCKOPTS
	select NET_LOOPBACK
	select NET_TCPBACKLOG
	select CRYPTO
	select NETUTILS_CODECS
	select CODECS_BASE64

config NYABULA_CORE_WEB_PORT
	int "Port of the product Web service"
	default 80
	range 1 65535
	depends on NYABULA_CORE_WEB
	---help---
		Port used when nyabula_web is started without arguments, which is
		how the system starts it.  The default is the one a browser assumes,
		so that the address printed on a QR code needs no port.

config NYABULA_CORE_WEB_TOKEN_PATH
	string "Access token of the product Web service"
	default "/config/nyabula/web.token"
	depends on NYABULA_CORE_WEB
	---help---
		Read when nyabula_web is started without arguments, and created
		from the system entropy source if absent.  It belongs with the
		configuration rather than the bulk store: wiping /data must not
		sign the owner out of their own device.

config NYABULA_CORE_WEB_AUTH_PATH
	string "Owner password record of the product Web service"
	default "/config/nyabula/web.auth"
	depends on NYABULA_CORE_WEB
	---help---
		Salted PBKDF2 hash of the password the owner signs in with.  It
		is configuration for the same reason the token is: wiping /data
		must not reset who may open the panel.

config NYABULA_CORE_WEB_ROOT
	string "Directory the product Web service serves pages from"
	default "/data/www"
	depends on NYABULA_CORE_WEB
	---help---
		Root of the built control panel.  Any request that is not for
		the WebSocket endpoint is answered from here, read-only.  It
		lives with the bulk data because it is replaced wholesale by an
		update and can be restored by one.

config NYABULA_CORE_HTTP
	bool "Enable Core non-blocking HTTP transport"
	default n
	depends on NET_TCP && NET_IPv4
	select NETUTILS_WEBCLIENT
	---help---
		Build the broker-owned transport using upstream webclient. The
		current transport accepts IPv4 HTTP endpoints and DNS hostnames.
		TLS requires further integration.

config NYABULA_CORE_PRIORITY
	int "Nyabula Core task priority"
	default 100

config NYABULA_CORE_BACKGROUND_PRIORITY
	int "Nyabula background plugin priority"
	default 80
	range 1 254

config NYABULA_CORE_STACKSIZE
	int "Nyabula Core task stack size"
	default 32768

config NYABULA_CORE_PLUGIN_MEMORY
	int "Maximum QuickJS heap per plugin"
	default 8388608

config NYABULA_CORE_PLUGIN_STACK
	int "Maximum QuickJS stack per plugin"
	default 262144

config NYABULA_CORE_EVENT_TIMEOUT_MS
	int "Maximum execution time per plugin event"
	default 100

config NYABULA_CORE_ASYNC_TIMEOUT_MS
	int "Maximum elapsed time per lifecycle callback"
	default 5000
	range 100 60000
	---help---
		Bound the entire asynchronous callback, including provider waits.
		The manifest CPU budget still bounds accumulated script execution;
		waiting for a completion does not replenish that budget.

config NYABULA_CORE_EVENTS_PER_MINUTE
	int "Default events allowed per plugin per minute"
	default 120
	range 1 600

config NYABULA_CORE_MAX_EVENTS_PER_MINUTE
	int "Maximum events a plugin may request per minute"
	default 600
	range 1 3600

config NYABULA_CORE_SOURCE_LIMIT
	int "Maximum plugin source size"
	default 1048576

config NYABULA_CORE_MANIFEST_LIMIT
	int "Maximum plugin manifest size"
	default 16384
	range 1024 65536

config NYABULA_CORE_REQUIRE_SIGNATURE
	bool "Require signed plugin packages"
	default y
	select LIBSODIUM

config NYABULA_CORE_TRUST_STORE
	string "Trusted plugin public key store"
	default "/data/nyabula/trusted-keys.json"
	depends on NYABULA_CORE_REQUIRE_SIGNATURE

config NYABULA_CORE_GRANT_STORE
	string "Plugin permission grant store"
	default "/data/nyabula/grants.json"

config NYABULA_CORE_PACKAGE_STORE
	string "Installed plugin package store"
	default "/data/nyabula/apps"

config NYABULA_CORE_HEALTH_STORE
	string "Plugin crash health store"
	default "/data/nyabula/health"

config NYABULA_CORE_REVOCATION_STORE
	string "Plugin signer and version revocation store"
	default "/data/nyabula/revocations.json"

config NYABULA_CORE_QUARANTINE_FAILURES
	int "Failures before a plugin version is quarantined"
	default 3
	range 1 100

config NYABULA_CORE_PACKAGE_FILE_LIMIT
	int "Maximum files per plugin package"
	default 128
	range 8 1024

config NYABULA_CORE_PACKAGE_SIZE_LIMIT
	int "Maximum verified plugin package size"
	default 8388608
	range 65536 67108864

config NYABULA_CORE_MAX_PLUGINS
	int "Maximum concurrently scheduled plugins"
	default 4
	range 1 16

config NYABULA_CORE_MAX_BACKGROUND_PLUGINS
	int "Maximum concurrently scheduled background plugins"
	default 2
	range 1 8

config NYABULA_CORE_EVENT_DEPTH
	int "Queued events per plugin"
	default 8
	range 1 64

config NYABULA_CORE_EVENT_SIZE
	int "Maximum event payload size"
	default 256
	range 32 4096

config NYABULA_CORE_STORAGE_VALUE_LIMIT
	int "Maximum private storage value size"
	default 4096
	range 128 65536

config NYABULA_CORE_AI_RESPONSE_LIMIT
	int "Maximum AI response size"
	default 4096
	range 128 65536

config NYABULA_CORE_STATE_SQLITE
	bool "Transactional Core state database"
	default y if !BUILD_KERNEL
	depends on !BUILD_KERNEL && !LIB_SQLITE
	---help---
		Use the upstream SQLite rollback journal for Core state. The flat
		build shares one serialized broker. Kernel builds require a single
		broker process before enabling this database integration.

config NYABULA_CORE_STATE_DATABASE
	string "Core private state database"
	default "/data/nyabula/core.sqlite"
	depends on NYABULA_CORE_STATE_SQLITE

config NYABULA_CORE_PRODUCT
	bool "Nyabula persistent product services"
	default n
	depends on NYABULA_CORE_STATE_SQLITE
	---help---
		Enable Core-owned product state and services shared by WebUI,
		plugins and the AI Agent. No state is owned by a browser session.

config NYABULA_CORE_OTA
	bool "Firmware update from the control panel"
	default n
	depends on NYABULA_CORE_PRODUCT && NYABULA_CORE_WEB
	depends on BOARDCTL_RESET && !DISABLE_MOUNTPOINT
	select CRYPTO
	---help---
		Accept an image over HTTP (POST /ota/upload?target=...), write it
		where update.apply is told to and report slot state in
		update.status.  The NuttX firmware and the AMP image are staged
		into the inactive N-Boot A/B slot of their domain; N-Boot itself
		and single partitions can be written raw, which the owner has to
		acknowledge as able to leave the board unbootable.  This drives
		the KICKPI-K7 bootctrl record and partition layout through the
		nbootctl sources: the layout and the handoff register are that
		board's, so enable it only there.  When SYSTEM_NBOOTCTL is built
		in, its objects are reused; otherwise the bootctrl and partition
		sources are compiled into Core.

config NYABULA_CORE_MODELS
	bool "Model files from the control panel"
	default y
	depends on NYABULA_CORE_PRODUCT && NYABULA_CORE_WEB
	depends on !DISABLE_MOUNTPOINT
	select CRYPTO
	---help---
		Accept model files over HTTP (PUT /models/upload?path=...) in
		resumable pieces, store them under /data/models after their
		SHA-256 has been verified, and list, verify and delete them
		through the models.* topics.  The models themselves are
		third-party files the owner brings; the firmware ships none.

config NYABULA_CORE_MEDIA
	bool "Native local media playback"
	default n
	depends on NYABULA_CORE_PRODUCT && AUDIO
	select SYSTEM_NXPLAYER
	select AUDIO_DRIVER_SPECIFIC_BUFFERS
	select NXPLAYER_INCLUDE_PREFERRED_DEVICE
	---help---
		Play local PCM WAV files through the existing NuttX audio stack.
		The product worker owns playback and device descriptors.

config NYABULA_CORE_MEDIA_ROOT
	string "Local media directory"
	default "/data/music"
	depends on NYABULA_CORE_MEDIA

config NYABULA_CORE_MEDIA_DEVICE
	string "Default output audio device"
	default "/dev/audio/pcm0"
	depends on NYABULA_CORE_MEDIA

config NYABULA_CORE_COMPUTE
	bool "AMP compute-domain link and model delivery"
	default n
	depends on NYABULA_CORE_PRODUCT && RPMSG_CHAR && RK3576_SHMEM
	depends on !DISABLE_MOUNTPOINT && !DISABLE_PTHREAD
	select CRYPTO
	---help---
		Own the RPMsg endpoint to the Linux compute domain for as long
		as the product runs: track its generation, route responses and
		events to local requesters, and serve the BLOB service, through
		which the compute domain (which has no storage of its own) pulls
		model files out of /data/models into windows of the shared
		arena.  Adds the compute.status topic.  When this is enabled the
		nyampctl diagnostic talks through it instead of opening the
		endpoint itself.

config NYABULA_CORE_COMPUTE_BOUNCE
	bool "Copy blob windows through a bounce buffer"
	default n
	depends on NYABULA_CORE_COMPUTE
	---help---
		Read model files into an ordinary buffer and copy that into the
		shared arena, instead of letting pread() write into the arena
		directly.  Slower; only for a storage driver that cannot
		transfer into the non-cacheable shared region.

config NYABULA_CORE_COMPUTE_LLM
	string "Default local LLM (name under /data/models)"
	default "llm/model.rkllm"
	depends on NYABULA_CORE_COMPUTE
	---help---
		The model ny_compute_chat() loads when none is loaded yet, and
		the one compute.llm.load loads when it is not given a name.  It
		is a logical name under /data/models; the compute domain pulls
		it, and the tokenizer.json beside it, on demand.

config NYABULA_CORE_AUDIO
	bool "ES8388 codec control (routes, volume, microphone)"
	default y
	depends on NYABULA_CORE_PRODUCT && AUDIO_ES8388
	---help---
		audio.* topics: output and microphone routing, volume, mute,
		microphone gain and channel processing of the ES8388, applied to
		the codec directly whether or not a stream is open.  Preferences
		live in the product store and are restored once the codec nodes
		appear.  music.volume and the audioctl command use the same path.

config NYABULA_CORE_AUDIO_OUTPUT_DEVICE
	string "ES8388 playback node"
	default "/dev/audio/pcm0"
	depends on NYABULA_CORE_AUDIO

config NYABULA_CORE_AUDIO_INPUT_DEVICE
	string "ES8388 capture node"
	default "/dev/audio/pcm_in0"
	depends on NYABULA_CORE_AUDIO

config NYABULA_CORE_STORAGE_BYTES_LIMIT
	int "Maximum stored value bytes per plugin"
	default 65536
	range 128 67108864

config NYABULA_CORE_STORAGE_KEYS_LIMIT
	int "Maximum stored keys per plugin"
	default 64
	range 1 1024

config NYABULA_CORE_JOB_LIMIT
	int "Maximum microtasks per plugin event"
	default 256
	range 8 4096

config NYABULA_CORE_MOCK_CAPABILITIES
	bool "Mock external capabilities"
	default y if ARCH_SIM
	default n
	---help---
		Use deterministic network, UI and AI capability mocks.  This is for
		the simulator and must remain disabled on production boards.

endif

config NYABULA_CORE_NETWORK
	bool "Native Wi-Fi provisioning (SoftAP -> STA state machine)"
	default y
	depends on NYABULA_CORE_PRODUCT && NET && WIRELESS_WAPI
	select NETUTILS_NETLIB
	select NETUTILS_DHCPC
	select NETUTILS_DHCPD if NET_UDP
	---help---
		network.* topics: SoftAP provisioning with QR payload, station
		connect with DHCP, credentials persisted in the product store.

config NYABULA_CORE_NETWORK_IFNAME
	string "Wi-Fi interface name"
	default "wlan0"
	depends on NYABULA_CORE_NETWORK

config NYABULA_CORE_TIMESYNC
	bool "Set the clock from network time servers (SNTP)"
	default y
	depends on NYABULA_CORE_NETWORK && NET_UDP && NETDB_DNSCLIENT
	---help---
		Ask a time server as soon as the station has an address, then
		every six hours, retrying after 15 s, 60 s and then every 5 min
		while none has answered.  The answer sets the system clock and,
		through it, the RTC.  Without this the clock is only ever set by
		the owner's panel.

config NYABULA_CORE_TIMESYNC_SERVERS
	string "Time servers, in the order they are asked"
	default "ntp.aliyun.com;ntp.tencent.com;cn.pool.ntp.org;pool.ntp.org"
	depends on NYABULA_CORE_TIMESYNC
	---help---
		Host names or IPv4 addresses separated by semicolons.  The
		defaults answer from inside mainland China, with the global pool
		last for everywhere else.

config NYABULA_CORE_TIMESYNC_STACKSIZE
	int "Stack of the thread that asks the time servers"
	default 16384
	depends on NYABULA_CORE_TIMESYNC
	---help---
		The thread lives for one round of questions.  Most of what it
		needs is the resolver's.

config NYABULA_CORE_CLOCK_RTC_PATH
	string "RTC that keeps the time across a power cycle"
	default "/dev/rtc0"
	depends on NYABULA_CORE_PRODUCT && RTC_DRIVER
	---help---
		Read at start to decide whether the clock can be believed, and
		checked -- written, if need be -- whenever the clock is set.
```
