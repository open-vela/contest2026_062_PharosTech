## app/audioctl/Kconfig
```kconfig
config SYSTEM_AUDIOCTL
	tristate "KICKPI-K7 audio control"
	default n
	depends on KICKPI_K7_AUDIO
	---help---
		Control ES8388 routing and hardware channel processing through
		/dev/audio/pcm0 ioctls.

if SYSTEM_AUDIOCTL

config SYSTEM_AUDIOCTL_PROGNAME
	string "Program name"
	default "audioctl"

config SYSTEM_AUDIOCTL_PRIORITY
	int "audioctl task priority"
	default 100

config SYSTEM_AUDIOCTL_STACKSIZE
	int "audioctl stack size"
	default 4096

endif
```

## app/emmcprobe/Kconfig
```kconfig
#
# For a description of the syntax of this configuration file,
# see the file kconfig-language.txt in the NuttX tools repository.
#

config EXAMPLES_EMMCPROBE
	tristate "KICKPI-K7 on-board eMMC (dwcmshc/SDHCI) bring-up probe"
	default n
	---help---
		Milestone-M1 bring-up self-test for the KICKPI-K7 on-board eMMC
		(mmc@2a330000, a Synopsys dwcmshc / SDHCI 3.0 host).  Reads the host
		version + capabilities, software-resets the host, brings up the
		clock + bus power, then enumerates the device with CMD0/CMD1 (and,
		if ready, CMD2/3/9/7 + a single-block PIO read).  Self-contained raw
		MMIO diagnostic, not wired into the board boot path; run as
		"emmcprobe" from NSH and read the results on the console/syslog.

if EXAMPLES_EMMCPROBE

config EXAMPLES_EMMCPROBE_PROGNAME
	string "Program name"
	default "emmcprobe"

config EXAMPLES_EMMCPROBE_PRIORITY
	int "emmcprobe task priority"
	default 100

config EXAMPLES_EMMCPROBE_STACKSIZE
	int "emmcprobe stack size"
	default 4096

endif
```

## app/nyabula/Kconfig
```kconfig
# SPDX-License-Identifier: Apache-2.0

config NYABULA_EYE_ENGINE
	bool "Nyabula dual-eye engine"
	depends on GRAPHICS_LVGL && LIBCXX && LIBCXXABI && !BUILD_KERNEL
	select LV_USE_FLOAT
	select LV_USE_VECTOR_GRAPHIC
	select LV_USE_THORVG
	select LV_USE_CANVAS
	select NETUTILS_CJSON
	---help---
		Build the existing expression/scene engine as a library. A display
		owner attaches two LVGL roots and drains the bounded command queue.

if NYABULA_EYE_ENGINE

config NYABULA_EYE_DISPLAY
	bool "Nyabula Eye display owner application"
	default n
	depends on GRAPHICS_NYABULA_DISPLAY=y
	---help---
		Build the nyabula_eye product entry point. It calls the public
		Display API and owns Eye/LVGL updates without using the Display demo.

if NYABULA_EYE_DISPLAY

config NYABULA_EYE_PRIORITY
	int "Eye display task priority"
	default 100

config NYABULA_EYE_STACKSIZE
	int "Eye display task stack size"
	default 32768

endif

config CONTEST2026_062_NYABULA_DYNAMIC_FONTS
	bool "Load complete Eye fonts with FreeType"
	default n
	select LIB_FREETYPE
	select LV_USE_FREETYPE

config CONTEST2026_062_NYABULA_FONT_ROOT
	string "Complete Eye font directory"
	default "/data/nyabula/fonts"
	depends on CONTEST2026_062_NYABULA_DYNAMIC_FONTS

endif
```
