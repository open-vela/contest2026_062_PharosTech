## chips/rk3576/Kconfig
```kconfig
#
# For a description of the syntax of this configuration file,
# see the file kconfig-language.txt in the NuttX tools repository.
#

config ARCH_CHIP_RK3576
	bool
	default y
	select ARCH_CORTEX_A53
	select ARCH_HAVE_ADDRENV
	select ARCH_HAVE_RESET
	select ARCH_NEED_ADDRENV_MAPPING
	select ARM64_HAVE_PSCI
	select ARCH_HAVE_IRQPRIO
	select CLK

if ARCH_CHIP_RK3576

choice
	prompt "RK3576 DDR Capacity"
	default RK3576_DDR_4G

config RK3576_DDR_2G
	bool "2 GB"
	---help---
		Select for 2 GB variant.

config RK3576_DDR_4G
	bool "4 GB"
	---help---
		Select for 4 GB variant.

config RK3576_DDR_8G
	bool "8 GB"
	---help---
		Select for 8 GB variant.

config RK3576_DDR_16G
	bool "16 GB"
	---help---
		Select for 16 GB variant.

endchoice

config RK3576_DDR_SIZE_GB
	int
	default 2 if RK3576_DDR_2G
	default 4 if RK3576_DDR_4G
	default 8 if RK3576_DDR_8G
	default 16 if RK3576_DDR_16G

menu "Rockchip RK3576 Peripheral Selection"

config RK3576_UART
	bool "UART serial"
	default y
	# select UART0_SERIALDRIVER triggers Kconfig-uart which provides
	# CONFIG_UART0_BAUD / CONFIG_UART0_BITS / …  — do NOT remove.
	select UART0_SERIALDRIVER
	# serial ports other than UART0 are configured dynamically
	# not by CONFIG_UARTn_xxx

	select ARCH_HAVE_SERIAL_TERMIOS
	---help---
		Select to enable support for UART.

config RK3576_SDMMC
	bool "SD/MMC (SDMMC0 - SD card)"
	default n
	select ARCH_HAVE_SDIO
	select MMCSD
	select MMCSD_SDIO
	select SDIO_DMA
	select ARCH_HAVE_SDIO_PREFLIGHT
	select SDIO_BLOCKSETUP
	---help---
		Enable the RK3576 SDMMC (SD card) host controller driver
		(Synopsys DesignWare MSHC, PIO + IDMAC internal DMA).

config RK3576_PWM
	bool "PWM (Rockchip PWM v4)"
	default n
	select PWM
	---help---
		Enable the RK3576 PWM driver (Rockchip PWM v4, PWM1 @ 2add0000, 6
		channels).  Continuous-mode output for servo/fan/LED control; the
		counting clock is the 24 MHz oscillator scaled to 12 MHz.  The
		board mux the output pin and registers /dev/pwmN.

config RK3576_EMMC
	bool "eMMC (dwcmshc / SDHCI)"
	default n
	select ARCH_HAVE_SDIO
	select MMCSD
	select MMCSD_SDIO
	select ARCH_HAVE_SDIO_PREFLIGHT
	select SDIO_BLOCKSETUP
	---help---
		Enable the RK3576 eMMC host controller driver (mmc@2a330000, a
		Synopsys dwcmshc / SDHCI 3.0 host -- a different IP from the
		SDMMC/SDIO dw-mshc hosts).  PIO data path, default/high-speed,
		1/4/8-bit bus.  HS400/CQE/DLL are not supported.  The bootloader
		leaves the eMMC CRU clock ungated, so no CRU/pinctrl setup is
		needed (non-removable, loader-configured).

config RK3576_GPIO
	bool "GPIO"
	default n
	select ARCH_HAVE_GPIO_IRQ
	---help---
		Select to enable support for the RK3576 GPIO controller.
		The RK3576 has 5 GPIO banks (GPIO0-GPIO4) with 32 pins each.

config RK3576_I2C
	bool "I2C master"
	default n
	select I2C
	---help---
		Enable the RK3576 I2C master driver (Rockchip RK I2C block,
		polled).  All ten I2C controllers (I2C0..I2C9) are supported;
		the driver is data-driven at runtime -- a per-controller config
		option is unnecessary on this platform.  The controller clock is
		brought up via the CRU; SCL/SDA pin muxing is the board's
		responsibility.

config RK3576_USB
	bool "RK3576 USB OTG0 controller (DWC3)"
	default n
	select USBDEV
	---help---
		Enable the RK3576 USB OTG0 controller driver (Synopsys DWC3 at
		0x23000000).  The controller is dual-role (OTG); this driver
		implements the device (peripheral/gadget) role, USB 2.0
		high-speed, for CDC/ACM and ADB gadget use cases.  The host
		(xHCI) role can be added alongside.

config RK3576_DMA
	bool "DMA (ARM PL330 / DMA-330)"
	default n
	---help---
		Enable the RK3576 ARM PL330 (DMA-330) DMA controller driver
		(dma-controller@2ab90000).  Micro-coded engine, 8 channels;
		single-shot memory-to-memory and peripheral (M2P/P2M) transfers.
		Chief consumer is the SAI/I2S audio driver.  Cyclic and
		scatter/gather transfers are not yet implemented.

config RK3576_SAI
	bool "SAI (I2S audio, sai-v1)"
	default n
	depends on RK3576_DMA
	select I2S
	select AUDIO
	---help---
		Enable the RK3576 SAI1 I2S audio driver (sai@2a610000, sai-v1), an
		i2s_dev_s lower-half that streams PCM to/from the SAI FIFO over the
		PL330 DMA (RK3576_DMA).  I2S master mode; drives an on-board ES8388
		codec (codec control is over I2C, board-registered separately).

endmenu # Rockchip RK3576 Peripheral Selection

config RK3576_OSC_FREQ
	int "RK3576 OSC Crystal Frequency (Hz)"
	default 24000000
	range 24000000 24000000 if !EXPERT
	help
		RK3576 only supports 24MHz crystal on hardware.
		Keep default unless you need fine-tune for clock calibration.

menu "Rockchip RK3576 DMA allocator"

config RK3576_DMA_ALLOC
	bool "RK3576 DMA-dedicated heap allocator"
	default n
	select GRAN
	---help---
		Reserve a configurable amount of memory from the head of Bank2
		(physically at 0x49400000) as a DMA-dedicated heap, ensuring all
		allocations are within the PL330 DMA 32-bit SAR/DAR addressable
		range (<4GB).  Allocations are D-Cache-line aligned (64B).
		Initialised during arm64_addregion(), available via
		rk3576_dma_alloc/free.

if RK3576_DMA_ALLOC

config RK3576_DMA_HEAP_SIZE_MB
	int "DMA heap size in MiB"
	default 16
	range 1 1024
	---help---
		Size of the DMA-dedicated heap in MiB, carved from the head of
		Bank2.  Default is 16 MiB.  The heap sits at 0x49400000 and
		the remainder of Bank2 starts after it.

endif # RK3576_DMA_ALLOC

endmenu # Rockchip RK3576 DMA allocator

endif # ARCH_CHIP_RK3576
```
