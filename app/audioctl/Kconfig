## app/nyabula_display/Kconfig
```kconfig
#
# For a description of the syntax of this configuration file,
# see the file kconfig-language.txt in the NuttX tools repository.
#

menuconfig GRAPHICS_NYABULA_DISPLAY
	tristate "Nyabula Display LVGL Compatibility Layer"
	default n
	depends on GRAPHICS_LVGL
	---help---
		Enable the Nyabula Display LVGL compatibility layer for NuttX.
		This provides LCD and touchscreen drivers for LVGL applications.

if GRAPHICS_NYABULA_DISPLAY

config NYABULA_DISPLAY_PRIORITY
	int "nyabula_display task priority"
	default 100

config NYABULA_DISPLAY_STACKSIZE
	int "nyabula_display stack size"
	default 32768

config NYABULA_DISPLAY_BUFFER_SIZE
	int "LCD buffer size in bytes"
	default 1048576
	---help---
		Size of the LCD draw buffer in bytes. Default is 1MB.

config NYABULA_DISPLAY_LCD_DEVPATH0
	string "First LCD device path"
	default "/dev/lcd0"
	---help---
		The path to the first LCD device.

config NYABULA_DISPLAY_LCD_DEVPATH1
	string "Second LCD device path"
	default "/dev/lcd1"
	---help---
		The path to the second LCD device.

config NYABULA_DISPLAY_SCREEN_WIDTH
	int "Screen width in pixels"
	default 360
	---help---
		Width of each screen in pixels.

config NYABULA_DISPLAY_SCREEN_HEIGHT
	int "Screen height in pixels"
	default 360
	---help---
		Height of each screen in pixels.

choice NYABULA_DISPLAY_TE_SOURCE
	prompt "TE (vertical sync) signal source"
	default NYABULA_DISPLAY_TE_SW
	---help---
		Select where the TE edges (scan-start / blank-start) come from.
		The algorithm and framework are source-agnostic (see
		nyabula_te.h): they only consume the two edge callbacks.

config NYABULA_DISPLAY_TE_SW
	bool "Software frame clock (no TE pin wired)"
	---help---
		Temporary scheme while the panel TE pins are not routed: a
		high-priority thread synthesizes the scan-start (TE falling) and
		blank-start (TE rising) edges at the frame rate, with the two
		screens staggered 90 degrees.

config NYABULA_DISPLAY_TE_BOARDCTL
	bool "Panel TE GPIO via boardctl-registered semaphores"
	depends on BOARDCTL_IOCTL
	---help---
		Each screen's TE pin drives a BOARD-LEVEL GPIO interrupt whose ISR
		classifies the edge direction at interrupt time (HIGH=blanking,
		LOW=scanning) and posts one semaphore per direction.  The
		semaphores are registered with the board through
		boardctl(BOARDIOC_USER).  This avoids both the POSIX-signal path
		and the stale pin-level read that the signal-based source suffers
		under heavy CPU load.  Requires the board to attach a driver-level
		both-edge interrupt on the TE pins and to implement a board_ioctl
		that accepts BOARDIOC_USER with a four-sem_t* array (bs0, ss0,
		bs1, ss1).
endchoice

config NYABULA_DISPLAY_AUDIT
	bool "Enable dual-screen audit / profiling instrumentation"
	default n
	---help---
		Per-screen runtime metrics (render time, transfer time, transfer
		FPS) printed periodically by the TE thread.  The metrics are
		collected because the dual-screen compat layer bypasses LVGL's
		built-in sysmon.

		When disabled, all instrumentation (and its storage/overhead) is
		stripped from the build.

endif # GRAPHICS_NYABULA_DISPLAY
```

## app/nyampctl/Kconfig
```kconfig
config EXAMPLES_NYAMPCTL
	tristate "Nyabula AMP control diagnostic"
	default n
	depends on RPMSG_CHAR
	---help---
		Build the nyampctl diagnostic for the Linux AMP compute domain:
		health, info, llm, blob and shmem commands.  It builds alone
		for the minimal AMP profile; when NYABULA_CORE_COMPUTE is also
		enabled it goes through that service, which then owns the
		endpoint.

if EXAMPLES_NYAMPCTL

config EXAMPLES_NYAMPCTL_PROGNAME
	string "Program name"
	default "nyampctl"

config EXAMPLES_NYAMPCTL_PRIORITY
	int "Task priority"
	default 100

config EXAMPLES_NYAMPCTL_STACKSIZE
	int "Task stack size"
	default 8192 if NYABULA_CORE_VOICE
	default 4096

endif
```
