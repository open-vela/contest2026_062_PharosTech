## configs/core_services/defconfig
```kconfig
# Portable native Core and eye-mirror regression profile.
CONFIG_ALLOW_ICS_COMPONENTS=y
CONFIG_HOST_LINUX=y
CONFIG_MODULES=y
CONFIG_BUILD_FLAT=y
CONFIG_OUTPUT_STRIP_PATHS=y
CONFIG_ARCH_HAVE_MATH_H=y
CONFIG_ARCH_HAVE_SETJMP=y
CONFIG_ARCH_SETJMP_H=y
CONFIG_ARCH_NONE_DEBUG_H=y
CONFIG_FORTIFY_SOURCE=0
CONFIG_NDEBUG=y
CONFIG_ARCH_HAVE_STACKCHECK=y
CONFIG_STACK_USAGE_WARNING=0
CONFIG_DEBUG_SYMBOLS=y
CONFIG_DEBUG_SYMBOLS_LEVEL="-g3"
CONFIG_ARCH_HAVE_CUSTOMOPT=y
CONFIG_DEBUG_CUSTOMOPT=y
CONFIG_DEBUG_OPTLEVEL="-DMAP_32BIT=0"
CONFIG_LTO_NONE=y
CONFIG_DEBUG_OPT_UNUSED_SECTIONS=y
CONFIG_DEBUG_LINK_MAP=y
CONFIG_ARCH_SIM=y
CONFIG_ARCH="sim"
CONFIG_ARCH_CHIP="sim"
CONFIG_HOST_X86_64=y
CONFIG_SIM_TOOLCHAIN_GCC=y
CONFIG_SIM_X8664_SYSTEMV=y
CONFIG_SIM_WALLTIME_SIGNAL=y
CONFIG_SIM_LOOP_INTERVAL=10
CONFIG_SIM_STACKSIZE_ADJUSTMENT=204800
CONFIG_SIM_NETUSRSOCK=y
CONFIG_SIM_OFFLOAD_NUM_BUFFERS=2
CONFIG_SIM_OFFLOAD_BUFFER_NUMBYTES=32767
CONFIG_SIM_UART_DMA=y
CONFIG_SIM_UART_NUMBER=0
CONFIG_SIM_CUSTOM_DATA_SECTION=""
CONFIG_ARCH_TOOLCHAIN_GNU=y
CONFIG_ARCH_TOOLCHAIN_GCC=y
CONFIG_ARCH_64BIT=y
CONFIG_ARCH_HAVE_TEXT_HEAP=y
CONFIG_ARCH_HAVE_MULTICPU=y
CONFIG_ARCH_HAVE_FORK=y
CONFIG_ARCH_HAVE_POWEROFF=y
CONFIG_ARCH_HAVE_RESET=y
CONFIG_ARCH_HAVE_RTC_SUBSECONDS=y
CONFIG_ARCH_HAVE_SYSCALL_HOOKS=y
CONFIG_ARCH_HAVE_BACKTRACE=y
CONFIG_ARCH_HAVE_CPUINFO=y
CONFIG_ARCH_CPUINFO_FREQ_KHZ=0
CONFIG_ARCH_HAVE_TCBINFO=y
CONFIG_ARCH_USE_TEXT_HEAP=y
CONFIG_STACK_ALIGN_SIZE=0
CONFIG_NCPUS=1
CONFIG_BOARD_LOOPSPERMSEC=0
CONFIG_BOOT_RUNFROMEXTSRAM=y
CONFIG_RAM_START=0x0
CONFIG_RAM_SIZE=0
CONFIG_ARCH_BOARD="sim"
CONFIG_ARCH_HAVE_BUTTONS=y
CONFIG_ARCH_HAVE_IRQBUTTONS=y
CONFIG_BOARD_CRASHDUMP_NONE=y
CONFIG_BOARDCTL=y
CONFIG_BOARDCTL_POWEROFF=y
CONFIG_BOARDCTL_MKRD=y
CONFIG_BOARDCTL_APP_SYMTAB=y
CONFIG_BOARD_MEMORY_RANGE=""
CONFIG_DISABLE_OS_API=y
CONFIG_ARCH_HAVE_TICKLESS=y
CONFIG_USEC_PER_TICK=10000
CONFIG_TIMER_ADJUST_USEC=0
CONFIG_ARCH_HAVE_TIMEKEEPING=y
CONFIG_START_YEAR=2008
CONFIG_START_MONTH=6
CONFIG_START_DAY=1
CONFIG_POSIX_TIMERS_MAX=32
CONFIG_PREALLOC_TIMERS=8
CONFIG_IRQ_NWORKS=8
CONFIG_IRQ_WORK_SECTION=""
CONFIG_IRQ_WORK_STACKSIZE=2048
CONFIG_UP=y
CONFIG_PERCPU_ARRAY=y
CONFIG_SMP_NCPUS=1
CONFIG_INIT_ENTRY=y
CONFIG_INIT_ARGS=""
CONFIG_INIT_STACKSIZE=2048
CONFIG_INIT_PRIORITY=100
CONFIG_INIT_ENTRYPOINT="nsh_main"
CONFIG_INIT_ENTRYNAME="nsh_main"
CONFIG_RR_INTERVAL=0
CONFIG_TASK_NAME_SIZE=31
CONFIG_SCHED_HAVE_PARENT=y
CONFIG_SCHED_WAITPID=y
CONFIG_PTHREAD_MUTEX_TYPES=y
CONFIG_PTHREAD_MUTEX_BOTH=y
CONFIG_PTHREAD_MUTEX_DEFAULT_UNSAFE=y
CONFIG_PTHREAD_MUTEX_DEFAULT_PRIO_NONE=y
CONFIG_SCHED_CPULOAD_SYSCLK=y
CONFIG_SCHED_CPULOAD_TICKSPERSEC=100
CONFIG_SCHED_CPULOAD_TIMECONSTANT=2
CONFIG_SCHED_PROFILE_TICKSPERSEC=1000
CONFIG_SCHED_STACK_RECORD=0
CONFIG_DEV_CONSOLE=y
CONFIG_NFILE_DESCRIPTORS_PER_BLOCK=8
CONFIG_FILE_STREAM=y
CONFIG_NAME_MAX=32
CONFIG_PATH_MAX=256
CONFIG_LINE_MAX=80
CONFIG_SIG_PREALLOC_ACTIONS=4
CONFIG_SIG_ALLOC_ACTIONS=1
CONFIG_SIG_PREALLOC_IRQ_ACTIONS=8
CONFIG_PREALLOC_MQ_MSGS=8
CONFIG_PREALLOC_MQ_IRQ_MSGS=8
CONFIG_MQ_MAXMSGSIZE=32
CONFIG_MODULE=y
CONFIG_SCHED_WORKQUEUE=y
CONFIG_SCHED_HPWORK=y
CONFIG_SCHED_HPNTHREADS=1
CONFIG_SCHED_HPWORKPRIORITY=224
CONFIG_SCHED_HPWORKSTACKSIZE=2048
CONFIG_SCHED_HPWORKSTACKSECTION=""
CONFIG_DEFAULT_TASK_STACKSIZE=2048
CONFIG_IDLETHREAD_STACKSIZE=4096
CONFIG_PTHREAD_STACK_MIN=256
CONFIG_PTHREAD_STACK_DEFAULT=2048
CONFIG_PTHREAD_GUARDSIZE_DEFAULT=0
CONFIG_SCHED_BACKTRACE=y
CONFIG_PID_INITIAL_COUNT=16
CONFIG_SCHED_EVENTS=y
CONFIG_DEV_URANDOM=y
CONFIG_DEV_URANDOM_RANDOM_POOL=y
CONFIG_DEV_LOOP=y
CONFIG_ONESHOT=y
CONFIG_ONESHOT_COUNT=y
CONFIG_ALARM_ARCH=y
CONFIG_DRIVERS_AUDIO=y
CONFIG_AUDIO_FAKE=y
CONFIG_AUDIO_FAKE_DEVICE_PARAMS="{\"pcm_test\", true, {8000,16000,44100,48000}, {1,2}, {16}, 50, 4}, {\"pcm_aux\", true, {8000,16000,44100,48000}, {1,2}, {16}, 50, 4}"
CONFIG_AUDIO_FAKE_DATA_PATH="/host/audio-out/"
CONFIG_AUDIO_FAKE_MSG_PRIO=1
CONFIG_AUDIO_FAKE_WORKER_STACKSIZE=2048
CONFIG_AUDIO_FAKE_WORKER_PRIORITY=252
CONFIG_BCH=y
CONFIG_BCH_BUFFER_ALIGNMENT=0
CONFIG_IOEXPANDER=y
CONFIG_IOEXPANDER_DUMMY=y
CONFIG_IOEXPANDER_DUMMY_INT_NCALLBACKS=4
CONFIG_IOEXPANDER_DUMMY_INT_POLLDELAY=500000
CONFIG_IOEXPANDER_INT_ENABLE=y
CONFIG_IOEXPANDER_NPINS=16
CONFIG_DEV_GPIO=y
CONFIG_DEV_GPIO_NPOLLWAITERS=1
CONFIG_DEV_GPIO_NSIGNALS=1
CONFIG_GPIO_LOWER_HALF=y
CONFIG_GPIO_LOWER_HALF_INTTYPE=14
CONFIG_LCD=y
CONFIG_LCD_PACKEDMSFIRST=y
CONFIG_LCD_DEV=y
CONFIG_LCD_MAXCONTRAST=63
CONFIG_LCD_MAXPOWER=1
CONFIG_LCD_LANDSCAPE=y
CONFIG_DEV_NULL=y
CONFIG_DEV_ZERO=y
CONFIG_DEV_OPTEE_NONE=y
CONFIG_DRVR_MKRD=y
CONFIG_NETDEVICES=y
CONFIG_DRIVERS_NOTE_MAX=1
CONFIG_DRIVERS_NOTE_CPUID=0
CONFIG_DRIVERS_NOTE_TASKNAME_BUFSIZE=256
CONFIG_DRIVERS_NOTE_CLOCKID=-1
CONFIG_DRIVERS_NOTE_RATELIMIT_INTERVAL=0
CONFIG_DRIVERS_NOTE_RATELIMIT_BURST=0
CONFIG_PIPES=y
CONFIG_DEV_PIPE_MAXSIZE=65535
CONFIG_DEV_PIPE_SIZE=1024
CONFIG_DEV_FIFO_SIZE=1024
CONFIG_DEV_PIPE_VFS_PATH="/var/pipe"
CONFIG_DEV_PIPE_NPOLLWAITERS=4
CONFIG_ARCH_HAVE_SERIAL_TERMIOS=y
CONFIG_SERIAL=y
CONFIG_SERIAL_CONSOLE=y
CONFIG_SERIAL_NPOLLWAITERS=4
CONFIG_SERIAL_IFLOWCONTROL=y
CONFIG_SERIAL_TXDMA=y
CONFIG_SERIAL_RXDMA=y
CONFIG_SYSLOG=y
CONFIG_SYSLOG_DEFAULT_MASK=0xff
CONFIG_SYSLOG_CRLF=y
CONFIG_SYSLOG_MAX_CHANNELS=1
CONFIG_SYSLOG_RATELIMIT_INTERVAL=0
CONFIG_SYSLOG_RATELIMIT_BURST=0
CONFIG_SYSLOG_DEVPATH="/dev/ttyS1"
CONFIG_SYSLOG_RPMSG_BUFFER_SECTION=""
CONFIG_SYSLOG_DEFAULT=y
CONFIG_NET_USRSOCK_DEVICE=y
CONFIG_ARCH_HAVE_NET=y
CONFIG_ARCH_HAVE_NETDEV_STATISTICS=y
CONFIG_NET_READAHEAD=y
CONFIG_NET=y
CONFIG_NET_DEFAULT_MIN_PORT=4096
CONFIG_NET_DEFAULT_MAX_PORT=32000
CONFIG_NET_ETH_PKTSIZE=590
CONFIG_NET_GUARDSIZE=2
CONFIG_NET_LL_GUARDSIZE=14
CONFIG_NET_RECV_BUFSIZE=0
CONFIG_NET_ETHERNET=y
CONFIG_NET_LOOPBACK=y
CONFIG_NET_LOOPBACK_PKTSIZE=0
CONFIG_NETDEV_IFINDEX=y
CONFIG_NET_IPv4=y
CONFIG_NET_FORWARD_ALLOC_STRUCT=1
CONFIG_NET_PREALLOC_DEVIF_CALLBACKS=16
CONFIG_NET_ALLOC_DEVIF_CALLBACKS=0
CONFIG_NET_SOCKOPTS=y
CONFIG_NET_IPV4_CHECKSUMS=y
CONFIG_NET_TCP=y
CONFIG_NET_TCP_CHECKSUMS=y
CONFIG_NET_TCP_PREALLOC_CONNS=8
CONFIG_NET_TCP_ALLOC_CONNS=0
CONFIG_NET_TCP_NPOLLWAITERS=2
CONFIG_NET_TCP_RTO=3
CONFIG_NET_TCP_MAXRTX=8
CONFIG_NET_TCP_MAXSYNRTX=5
CONFIG_NET_TCP_WAIT_TIMEOUT=120
CONFIG_NET_MAX_LISTENPORTS=20
CONFIG_NET_TCP_FAST_RETRANSMIT=y
CONFIG_NET_TCPBACKLOG=y
CONFIG_NET_TCPBACKLOG_CONNS=8
CONFIG_NET_UDP=y
CONFIG_NET_UDP_PREALLOC_CONNS=8
CONFIG_NET_UDP_ALLOC_CONNS=0
CONFIG_NET_UDP_NPOLLWAITERS=1
CONFIG_NET_ICMP=y
CONFIG_NET_ICMP_PMTU_ENTRIES=0
CONFIG_NET_ICMP_CHECKSUMS=y
CONFIG_NET_IGMP_CHECKSUMS=y
CONFIG_NET_ARP=y
CONFIG_NET_ARPTAB_SIZE=16
CONFIG_NET_ARP_MAXAGE=120
CONFIG_NET_ARP_MAXAGE_UNREACHABLE=1
CONFIG_NET_ARP_SEND=y
CONFIG_ARP_SEND_MAXTRIES=5
CONFIG_ARP_SEND_DELAYMSEC=20
CONFIG_NET_ARP_PREALLOC_STATES=2
CONFIG_NET_ARP_ALLOC_STATES=1
CONFIG_NET_ARP_MAX_STATES=0
CONFIG_NET_USRSOCK=y
CONFIG_NET_USRSOCK_PREALLOC_CONNS=12
CONFIG_NET_USRSOCK_ALLOC_CONNS=0
CONFIG_NET_USRSOCK_NPOLLWAITERS=1
CONFIG_NET_SNOOP_BUFSIZE=4096
CONFIG_NET_RECV_PACK=y
CONFIG_CRYPTO=y
CONFIG_CRYPTO_RANDOM_POOL=y
CONFIG_CRYPTO_RANDOM_POOL_COLLECT_IRQ_RANDOMNESS=y
CONFIG_FS_NEPOLL_DESCRIPTORS=8
CONFIG_FS_LOCK_BUCKET_SIZE=0
CONFIG_PSEUDOFS_ATTRIBUTES=y
CONFIG_FS_LINKS=y
CONFIG_PSEUDOFS_FILE=y
CONFIG_SENDFILE_BUFSIZE=512
CONFIG_FS_HEAPSIZE=0
CONFIG_FS_AIO_LISTIO_MAX=10
CONFIG_FS_MQUEUE_VFS_PATH="/var/mqueue"
CONFIG_FS_MQUEUE_NPOLLWAITERS=4
CONFIG_FS_RAMMAP=y
CONFIG_FS_ANONMAP=y
CONFIG_FS_FAT=y
CONFIG_FAT_LCNAMES=y
CONFIG_FAT_LFN=y
CONFIG_FAT_MAXFNAME=32
CONFIG_FAT_LFN_ALIAS_TRAILCHARS=0
CONFIG_FS_BINFS=y
CONFIG_FS_PROCFS=y
CONFIG_FS_HOSTFS=y
CONFIG_NXFONTS_PACKEDMSFIRST=y
CONFIG_MM_DEFAULT_MANAGER=y
CONFIG_MM_POOL_PARAM=""
CONFIG_MM_DEFAULT_ALIGNMENT=0
CONFIG_MM_NODE_GUARDSIZE=0
CONFIG_MM_REGIONS=1
CONFIG_MM_FREE_DELAYCOUNT_MAX=0
CONFIG_MM_HEAP_BIGGEST_COUNT=30
CONFIG_MM_HEAP_MEMPOOL_THRESHOLD=-1
CONFIG_MM_IOB=y
CONFIG_IOB_NBUFFERS=24
CONFIG_IOB_BUFSIZE=196
CONFIG_IOB_ALIGNMENT=4
CONFIG_IOB_SECTION=""
CONFIG_IOB_NCHAINS=24
CONFIG_IOB_THROTTLE=0
CONFIG_AUDIO=y
CONFIG_AUDIO_NUM_BUFFERS=2
CONFIG_AUDIO_BUFFER_NUMBYTES=8192
CONFIG_AUDIO_DRIVER_SPECIFIC_BUFFERS=y
CONFIG_AUDIO_FORMAT_PCM=y
CONFIG_AUDIO_FORMAT_MP3=y
CONFIG_AUDIO_FORMAT_SBC=y
CONFIG_AUDIO_FORMAT_AMR=y
CONFIG_AUDIO_FORMAT_OPUS=y
CONFIG_AUDIO_EXCLUDE_EQUALIZER=y
CONFIG_AUDIO_EXCLUDE_REWIND=y
CONFIG_PATH_INITIAL="/bin"
CONFIG_BINFMT_ELF_RELOCATABLE=y
CONFIG_STDIO_BUFFER_SIZE=64
CONFIG_STDIO_LINEBUFFER=y
CONFIG_NUNGET_CHARS=2
CONFIG_LIBC_FLOATINGPOINT=y
CONFIG_LIBC_LONG_LONG=y
CONFIG_LIBC_NUMBERED_ARGS=y
CONFIG_LIBC_NL_ARGMAX=9
CONFIG_LIBC_ATOMIC_TOOLCHAIN=y
CONFIG_ARCH_LOWPUTC=y
CONFIG_LIBC_ARCH_ELF=y
CONFIG_LIBC_RAND_ORDER=1
CONFIG_LIBC_HOMEDIR="/"
CONFIG_LIBC_TMPDIR="/tmp"
CONFIG_LIBC_MAX_TMPFILE=32
CONFIG_LIBC_MAX_EXITFUNS=1
CONFIG_LIBC_EXECFUNCS=y
CONFIG_POSIX_SPAWN_DEFAULT_STACKSIZE=2048
CONFIG_LIBC_HOSTNAME=""
CONFIG_LIBC_OPEN_MAX=256
CONFIG_LIBC_STRERROR_ERRNUM=y
CONFIG_LIBC_STRSIGNAL=y
CONFIG_LIBC_DLFCN=y
CONFIG_LDPATH_INITIAL=""
CONFIG_LIBC_ELF=y
CONFIG_LIBC_ELF_MAXDEPEND=2
CONFIG_LIBC_ELF_ALIGN_LOG2=2
CONFIG_LIBC_ELF_BUFFERSIZE=32
CONFIG_LIBC_ELF_BUFFERINCR=32
CONFIG_LIBC_ELF_RELOCATION_BUFFERCOUNT=256
CONFIG_LIBC_ELF_SYMBOL_CACHECOUNT=256
CONFIG_LIBC_ELF_SECTION_ALIGNMENT=8
CONFIG_LIBC_LOCALE=y
CONFIG_LIBC_LOCALE_CATALOG=y
CONFIG_LIBC_LOCALE_GETTEXT=y
CONFIG_LIBC_LOCALE_PATH="/etc/locale"
CONFIG_TLS_NELEM=4
CONFIG_TLS_TASK_NELEM=4
CONFIG_TLS_NCLEANUP=0
CONFIG_LIBC_NETDB=y
CONFIG_LIBC_GAISTRERROR_ERRNUM=y
CONFIG_NETDB_BUFSIZE=256
CONFIG_NETDB_MAX_IPv4ADDR=1
CONFIG_NETDB_DNSCLIENT=y
CONFIG_NETDB_DNSCLIENT_ENTRIES=8
CONFIG_NETDB_DNSCLIENT_NAMESIZE=256
CONFIG_NETDB_DNSCLIENT_LIFESEC=3600
CONFIG_NETDB_DNSCLIENT_MAXRESPONSE=512
CONFIG_NETDB_DNSCLIENT_RECV_TIMEOUT=30
CONFIG_NETDB_DNSCLIENT_SEND_TIMEOUT=30
CONFIG_NETDB_DNSCLIENT_RETRIES=3
CONFIG_NETDB_DNSSERVER_NAMESERVERS=1
CONFIG_NETDB_DNSSERVER_IPv4=y
CONFIG_NETDB_DNSSERVER_IPv4ADDR=0x0a000001
CONFIG_LIBC_ENVPATH=y
CONFIG_LIBC_FTOK_VFS_PATH="/var/ftok"
CONFIG_LIBC_MEMFD_ERROR=y
CONFIG_LIBC_TEMPBUFFER=y
CONFIG_LIBC_MAX_TEMPBUFFER=2
CONFIG_LIBC_TEMPBUFFER_MALLOC=y
CONFIG_LIBC_BACKTRACE_DEPTH=0
CONFIG_BUILTIN=y
CONFIG_STREAM_OUT_BUFFER_SIZE=64
CONFIG_STREAM_HEXDUMP_BUFFER_SIZE=128
CONFIG_STREAM_BASE64_BUFFER_SIZE=128
CONFIG_LIBC_INLINE_QUEUE=y
CONFIG_LIBM_TOOLCHAIN=y
CONFIG_HAVE_CXX=y
CONFIG_HAVE_CXXINITIALIZE=y
CONFIG_LIBCXX=y
CONFIG_LIBCXXABI=y
CONFIG_LIBCXXABI_VERSION="17.0.6"
CONFIG_CXX_STANDARD="gnu++20"
CONFIG_CXX_MINI_LOCALIZATION=y
CONFIG_LIBCXX_VERSION="17.0.6"
CONFIG_BUILTIN_TOOLCHAIN=y
CONFIG_COVERAGE_NONE=y
CONFIG_COVERAGE_DEFAULT_PREFIX_STRIP="0"
CONFIG_COVERAGE_DEFAULT_PREFIX="/data"
CONFIG_PROFILE_NONE=y
CONFIG_LIBSODIUM=y
CONFIG_LIBSODIUM_VERSION="1.0.18"
CONFIG_CRYPTO_MBEDTLS=y
CONFIG_MBEDTLS_VERSION="3.4.0"
CONFIG_MBEDTLS_SSL_IN_CONTENT_LEN=16384
CONFIG_MBEDTLS_SSL_OUT_CONTENT_LEN=16384
CONFIG_MBEDTLS_SSL_SRV_C=y
CONFIG_MBEDTLS_SSL_DTLS_CLIENT_PORT_REUSE=y
CONFIG_MBEDTLS_CAMELLIA_C=y
CONFIG_MBEDTLS_PADLOCK_C=y
CONFIG_MBEDTLS_TIMING_C=y
CONFIG_MBEDTLS_SSL_KEEP_PEER_CERTIFICATE=y
CONFIG_MBEDTLS_SSL_PROTO_DTLS=y
CONFIG_MBEDTLS_SSL_DTLS_ANTI_REPLAY=y
CONFIG_MBEDTLS_SSL_DTLS_HELLO_VERIFY=y
CONFIG_MBEDTLS_SSL_DTLS_CONNECTION_ID=y
CONFIG_MBEDTLS_SSL_DTLS_CONNECTION_ID_COMPAT=0
CONFIG_MBEDTLS_SSL_ALPN=y
CONFIG_MBEDTLS_ECP_WINDOW_SIZE=6
CONFIG_MBEDTLS_CMAC_C=y
CONFIG_MBEDTLS_NET_C=y
CONFIG_MBEDTLS_ECDSA_C=y
CONFIG_MBEDTLS_ECP_C=y
CONFIG_MBEDTLS_ECP_DP_SECP256R1_ENABLED=y
CONFIG_MBEDTLS_PEM_WRITE_C=y
CONFIG_MBEDTLS_PK_WRITE_C=y
CONFIG_MBEDTLS_X509_CREATE_C=y
CONFIG_MBEDTLS_X509_CRT_WRITE_C=y
CONFIG_MBEDTLS_X509_CSR_WRITE_C=y
CONFIG_MBEDTLS_X509_CSR_PARSE_C=y
CONFIG_MBEDTLS_HAVE_ASM=y
CONFIG_MBEDTLS_HAVE_TIME_DATE=y
CONFIG_MBEDTLS_CIPHER_MODE_CFB=y
CONFIG_MBEDTLS_CIPHER_MODE_CTR=y
CONFIG_MBEDTLS_CIPHER_MODE_OFB=y
CONFIG_MBEDTLS_CIPHER_MODE_XTS=y
CONFIG_MBEDTLS_CIPHER_PADDING_PKCS7=y
CONFIG_MBEDTLS_CIPHER_PADDING_ONE_AND_ZEROS=y
CONFIG_MBEDTLS_CIPHER_PADDING_ZEROS_AND_LEN=y
CONFIG_MBEDTLS_CIPHER_PADDING_ZEROS=y
CONFIG_MBEDTLS_ECP_DP_SECP192R1_ENABLED=y
CONFIG_MBEDTLS_ECP_DP_SECP224R1_ENABLED=y
CONFIG_MBEDTLS_ECP_DP_SECP384R1_ENABLED=y
CONFIG_MBEDTLS_ECP_DP_SECP521R1_ENABLED=y
CONFIG_MBEDTLS_ECP_DP_SECP192K1_ENABLED=y
CONFIG_MBEDTLS_ECP_DP_SECP224K1_ENABLED=y
CONFIG_MBEDTLS_ECP_DP_SECP256K1_ENABLED=y
CONFIG_MBEDTLS_ECP_DP_BP256R1_ENABLED=y
CONFIG_MBEDTLS_ECP_DP_BP384R1_ENABLED=y
CONFIG_MBEDTLS_ECP_DP_BP512R1_ENABLED=y
CONFIG_MBEDTLS_ECP_DP_CURVE25519_ENABLED=y
CONFIG_MBEDTLS_ECP_DP_CURVE448_ENABLED=y
CONFIG_MBEDTLS_ECP_NIST_OPTIM=y
CONFIG_MBEDTLS_ECDSA_DETERMINISTIC=y
CONFIG_MBEDTLS_KEY_EXCHANGE_PSK_ENABLED=y
CONFIG_MBEDTLS_KEY_EXCHANGE_DHE_PSK_ENABLED=y
CONFIG_MBEDTLS_KEY_EXCHANGE_ECDHE_PSK_ENABLED=y
CONFIG_MBEDTLS_KEY_EXCHANGE_RSA_PSK_ENABLED=y
CONFIG_MBEDTLS_KEY_EXCHANGE_DHE_RSA_ENABLED=y
CONFIG_MBEDTLS_KEY_EXCHANGE_ECDHE_RSA_ENABLED=y
CONFIG_MBEDTLS_KEY_EXCHANGE_ECDHE_ECDSA_ENABLED=y
CONFIG_MBEDTLS_KEY_EXCHANGE_ECDH_RSA_ENABLED=y
CONFIG_MBEDTLS_PK_PARSE_EC_EXTENDED=y
CONFIG_MBEDTLS_ERROR_STRERROR_DUMMY=y
CONFIG_MBEDTLS_GENPRIME=y
CONFIG_MBEDTLS_PK_RSA_ALT_SUPPORT=y
CONFIG_MBEDTLS_SSL_CONTEXT_SERIALIZATION=y
CONFIG_MBEDTLS_SSL_ENCRYPT_THEN_MAC=y
CONFIG_MBEDTLS_SSL_EXTENDED_MASTER_SECRET=y
CONFIG_MBEDTLS_SSL_RENEGOTIATION=y
CONFIG_MBEDTLS_SSL_MAX_FRAGMENT_LENGTH=y
CONFIG_MBEDTLS_SSL_TLS1_3_KEY_EXCHANGE_MODE_PSK_ENABLED=y
CONFIG_MBEDTLS_SSL_TLS1_3_KEY_EXCHANGE_MODE_EPHEMERAL_ENABLED=y
CONFIG_MBEDTLS_SSL_TLS1_3_KEY_EXCHANGE_MODE_PSK_EPHEMERAL_ENABLED=y
CONFIG_MBEDTLS_SSL_MAX_EARLY_DATA_SIZE=1024
CONFIG_MBEDTLS_SSL_SESSION_TICKETS=y
CONFIG_MBEDTLS_SSL_SERVER_NAME_INDICATION=y
CONFIG_MBEDTLS_VERSION_FEATURES=y
CONFIG_MBEDTLS_X509_RSASSA_PSS_SUPPORT=y
CONFIG_MBEDTLS_AESCE_C=y
CONFIG_MBEDTLS_ARIA_C=y
CONFIG_MBEDTLS_CCM_C=y
CONFIG_MBEDTLS_CHACHA20_C=y
CONFIG_MBEDTLS_CHACHAPOLY_C=y
CONFIG_MBEDTLS_DHM_C=y
CONFIG_MBEDTLS_ECDH_C=y
CONFIG_MBEDTLS_ECJPAKE_C=y
CONFIG_MBEDTLS_ERROR_C=y
CONFIG_MBEDTLS_GCM_C=y
CONFIG_MBEDTLS_HKDF_C=y
CONFIG_MBEDTLS_HMAC_DRBG_C=y
CONFIG_MBEDTLS_LMS_C=y
CONFIG_MBEDTLS_NIST_KW_C=y
CONFIG_MBEDTLS_PKCS5_C=y
CONFIG_MBEDTLS_PKCS7_C=y
CONFIG_MBEDTLS_PKCS12_C=y
CONFIG_MBEDTLS_PLATFORM_C=y
CONFIG_MBEDTLS_POLY1305_C=y
CONFIG_MBEDTLS_PSA_CRYPTO_C=y
CONFIG_MBEDTLS_PSA_CRYPTO_STORAGE_C=y
CONFIG_MBEDTLS_PSA_ITS_FILE_C=y
CONFIG_PSA_ITS_STORAGE_PREFIX=""
CONFIG_MBEDTLS_RIPEMD160_C=y
CONFIG_MBEDTLS_SHA384_C=y
CONFIG_MBEDTLS_SHA512_C=y
CONFIG_MBEDTLS_SHA3_C=y
CONFIG_MBEDTLS_SSL_CACHE_C=y
CONFIG_MBEDTLS_VERSION_C=y
CONFIG_MBEDTLS_X509_CRL_PARSE_C=y
CONFIG_MBEDTLS_SSL_TLS1_3_TICKET_AGE_TOLERANCE=6000
CONFIG_MBEDTLS_SSL_TLS1_3_TICKET_NONCE_LENGTH=32
CONFIG_MBEDTLS_SSL_TLS1_3_DEFAULT_NEW_SESSION_TICKETS=1
CONFIG_EXAMPLES_EYEPROBE=y
CONFIG_EXAMPLES_GPIO=y
CONFIG_EXAMPLES_GPIO_PROGNAME="gpio"
CONFIG_EXAMPLES_GPIO_PRIORITY=100
CONFIG_EXAMPLES_GPIO_STACKSIZE=2048
CONFIG_EXAMPLES_HELLO=y
CONFIG_EXAMPLES_HELLO_PROGNAME="hello"
CONFIG_EXAMPLES_HELLO_PRIORITY=100
CONFIG_EXAMPLES_HELLO_STACKSIZE=2048
CONFIG_FASTDDS_NoExample=y
CONFIG_LIB_GOOGLEBENCHMARK_PRIORITY=100
CONFIG_LIB_GOOGLEBENCHMARK_STACKSIZE=2048
CONFIG_LIB_JSONC_PRIORITY=100
CONFIG_LIB_JSONC_STACKSIZE=2048
CONFIG_UTILS_STRESS_STACKSIZE=36864
CONFIG_UTILS_STRESS_PRIORITY=100
CONFIG_ZEPHYR_REPO_DEFAULT=y
CONFIG_FSUTILS_MKFATFS=y
CONFIG_MKFATFS_BUFFER_ALIGNMENT=0
CONFIG_GRAPHICS_LVGL=y
CONFIG_LV_OPTLEVEL=""
CONFIG_LV_CONF_SKIP=y
CONFIG_LV_COLOR_DEPTH_16=y
CONFIG_LV_COLOR_DEPTH=16
CONFIG_LV_USE_CLIB_MALLOC=y
CONFIG_LV_USE_CLIB_STRING=y
CONFIG_LV_USE_CLIB_SPRINTF=y
CONFIG_LV_DEF_REFR_PERIOD=33
CONFIG_LV_DPI_DEF=130
CONFIG_LV_OS_NONE=y
CONFIG_LV_USE_OS=0
CONFIG_LV_DRAW_BUF_STRIDE_ALIGN=1
CONFIG_LV_DRAW_BUF_ALIGN=4
CONFIG_LV_DRAW_LAYER_SIMPLE_BUF_SIZE=24576
CONFIG_LV_USE_DRAW_SW=y
CONFIG_LV_DRAW_SW_DRAW_UNIT_CNT=1
CONFIG_LV_DRAW_SW_COMPLEX=y
CONFIG_LV_DRAW_SW_SHADOW_CACHE_SIZE=0
CONFIG_LV_DRAW_SW_CIRCLE_CACHE_SIZE=4
CONFIG_LV_DRAW_SW_LAYER_SIMPLE_BUF_SIZE=24576
CONFIG_LV_DRAW_SW_ASM_NONE=y
CONFIG_LV_USE_DRAW_SW_ASM=0
CONFIG_LV_USE_VECTOR_GRAPHIC=y
CONFIG_LV_DECODER_IMG_SIZE_EXPAND=0
CONFIG_LV_USE_LOG=y
CONFIG_LV_LOG_LEVEL_USER=y
CONFIG_LV_LOG_LEVEL=4
CONFIG_LV_LOG_USE_TIMESTAMP=y
CONFIG_LV_LOG_USE_FILE_LINE=y
CONFIG_LV_LOG_TRACE_MEM=y
CONFIG_LV_LOG_TRACE_TIMER=y
CONFIG_LV_LOG_TRACE_INDEV=y
CONFIG_LV_LOG_TRACE_DISP_REFR=y
CONFIG_LV_LOG_TRACE_EVENT=y
CONFIG_LV_LOG_TRACE_OBJ_CREATE=y
CONFIG_LV_LOG_TRACE_LAYOUT=y
CONFIG_LV_LOG_TRACE_ANIM=y
CONFIG_LV_LOG_TRACE_CACHE=y
CONFIG_LV_USE_ASSERT_NULL=y
CONFIG_LV_USE_ASSERT_MALLOC=y
CONFIG_LV_ASSERT_HANDLER_INCLUDE="assert.h"
CONFIG_LV_CACHE_DEF_SIZE=0
CONFIG_LV_IMAGE_HEADER_CACHE_DEF_CNT=0
CONFIG_LV_GRADIENT_MAX_STOPS=8
CONFIG_LV_COLOR_MIX_ROUND_OFS=128
CONFIG_LV_OBJ_STYLE_CACHE=y
CONFIG_LV_DRAW_TASK_DEFAULT_ALLOCATOR=y
CONFIG_LV_DRAW_TASK_USE_ALLOCATOR=0
CONFIG_LV_ATTRIBUTE_MEM_ALIGN_SIZE=1
CONFIG_LV_USE_FLOAT=y
CONFIG_LV_USE_MATRIX=y
CONFIG_LV_FONT_MONTSERRAT_14=y
CONFIG_LV_FONT_DEFAULT_MONTSERRAT_14=y
CONFIG_LV_FONT_FMT_TXT_LARGE=y
CONFIG_LV_USE_FONT_PLACEHOLDER=y
CONFIG_LV_TXT_ENC_UTF8=y
CONFIG_LV_TXT_BREAK_CHARS=" ,.;:-_)]}"
CONFIG_LV_TXT_LINE_BREAK_LONG_LEN=0
CONFIG_LV_WIDGETS_HAS_DEFAULT_VALUE=y
CONFIG_LV_USE_ANIMIMG=y
CONFIG_LV_USE_ARC=y
CONFIG_LV_USE_ARCLABEL=y
CONFIG_LV_USE_BAR=y
CONFIG_LV_USE_BUTTON=y
CONFIG_LV_USE_BUTTONMATRIX=y
CONFIG_LV_USE_CALENDAR=y
CONFIG_LV_USE_CALENDAR_HEADER_ARROW=y
CONFIG_LV_USE_CALENDAR_HEADER_DROPDOWN=y
CONFIG_LV_USE_CANVAS=y
CONFIG_LV_USE_CHART=y
CONFIG_LV_USE_CHECKBOX=y
CONFIG_LV_USE_DROPDOWN=y
CONFIG_LV_USE_IMAGE=y
CONFIG_LV_USE_IMAGEBUTTON=y
CONFIG_LV_USE_KEYBOARD=y
CONFIG_LV_USE_LABEL=y
CONFIG_LV_LABEL_TEXT_SELECTION=y
CONFIG_LV_LABEL_LONG_TXT_HINT=y
CONFIG_LV_LABEL_WAIT_CHAR_COUNT=3
CONFIG_LV_USE_LED=y
CONFIG_LV_USE_LINE=y
CONFIG_LV_USE_LIST=y
CONFIG_LV_USE_MENU=y
CONFIG_LV_USE_MSGBOX=y
CONFIG_LV_USE_SLIDER=y
CONFIG_LV_USE_SWITCH=y
CONFIG_LV_USE_TEXTAREA=y
CONFIG_LV_TEXTAREA_DEF_PWD_SHOW_TIME=1500
CONFIG_LV_USE_TABLE=y
CONFIG_LV_USE_ROLLER=y
CONFIG_LV_USE_SCALE=y
CONFIG_LV_USE_SPAN=y
CONFIG_LV_SPAN_SNIPPET_STACK_SIZE=64
CONFIG_LV_USE_SPINBOX=y
CONFIG_LV_USE_SPINNER=y
CONFIG_LV_USE_TABVIEW=y
CONFIG_LV_USE_TILEVIEW=y
CONFIG_LV_USE_WIN=y
CONFIG_LV_USE_THEME_DEFAULT=y
CONFIG_LV_THEME_DEFAULT_GROW=y
CONFIG_LV_THEME_DEFAULT_TRANSITION_TIME=80
CONFIG_LV_USE_THEME_SIMPLE=y
CONFIG_LV_USE_FLEX=y
CONFIG_LV_USE_GRID=y
CONFIG_LV_FS_DEFAULT_DRIVE_LETTER=0
CONFIG_LV_USE_QRCODE=y
CONFIG_LV_USE_THORVG=y
CONFIG_LV_USE_THORVG_INTERNAL=y
CONFIG_LV_USE_SNAPSHOT=y
CONFIG_LV_USE_OBSERVER=y
CONFIG_LV_BUILD_EXAMPLES=y
CONFIG_GRAPHICS_NYABULA_DISPLAY=y
CONFIG_NYABULA_DISPLAY_PRIORITY=100
CONFIG_NYABULA_DISPLAY_STACKSIZE=32768
CONFIG_NYABULA_DISPLAY_BUFFER_SIZE=1048576
CONFIG_NYABULA_DISPLAY_LCD_DEVPATH0="/dev/lcd0"
CONFIG_NYABULA_DISPLAY_LCD_DEVPATH1="/dev/lcd1"
CONFIG_NYABULA_DISPLAY_SCREEN_WIDTH=360
CONFIG_NYABULA_DISPLAY_SCREEN_HEIGHT=360
CONFIG_NYABULA_DISPLAY_TE_SW=y
CONFIG_NYABULA_EYE_ENGINE=y
CONFIG_NYABULA_EYE_WS=y
CONFIG_NYABULA_EYE_DISPLAY=y
CONFIG_NYABULA_EYE_PRIORITY=100
CONFIG_NYABULA_EYE_STACKSIZE=32768
CONFIG_INTERPRETERS_QUICKJS=y
CONFIG_INTERPRETERS_QUICKJS_NONE=y
CONFIG_INTERPRETERS_QUICKJS_PRIORITY=100
CONFIG_INTERPRETERS_QUICKJS_STACKSIZE=8192
CONFIG_INTERPRETERS_QUICKJS_MEMORY_LEAK_TRACE_SIZE=0
CONFIG_INTERPRETERS_WAMR=y
CONFIG_INTERPRETERS_WAMR_VERSION="WAMR-2.1.0"
CONFIG_INTERPRETERS_WAMR_CLASSIC=y
CONFIG_INTERPRETERS_WAMR_STACK_GUARD_SIZE=1024
CONFIG_INTERPRETERS_WAMR_THREAD_MGR=y
CONFIG_INTERPRETERS_WAMR_BULK_MEMORY=y
CONFIG_INTERPRETERS_WAMR_DISABLE_HW_BOUND_CHECK=y
CONFIG_NETUTILS_CJSON=y
CONFIG_NETUTILS_CJSON_URL="https://github.com/DaveGamble/cJSON/archive"
CONFIG_NETUTILS_CJSON_VERSION="1.7.12"
CONFIG_NETUTILS_CODECS=y
CONFIG_CODECS_BASE64=y
CONFIG_NETUTILS_MQTTC=y
CONFIG_NETUTILS_MQTTC_VERSION="1.1.5"
CONFIG_NETUTILS_NETINIT=y
CONFIG_NETINIT_IPADDR=0x0a000002
CONFIG_NETINIT_DRIPADDR=0x0a000001
CONFIG_NETINIT_NETMASK=0xffffff00
CONFIG_NETUTILS_NETLIB=y
CONFIG_NETUTILS_NETLIB_GENERICURLPARSER=y
CONFIG_NETUTILS_WEBCLIENT=y
CONFIG_NSH_WGET_USERAGENT="NuttX/6.xx.x (; http://www.nuttx.org/)"
CONFIG_WEBCLIENT_TIMEOUT=10
CONFIG_WEBCLIENT_MAXHTTPLINE=200
CONFIG_WEBCLIENT_MAXMIMESIZE=32
CONFIG_WEBCLIENT_MAXHOSTNAME=40
CONFIG_WEBCLIENT_MAXFILENAME=100
CONFIG_NSH_LIBRARY=y
CONFIG_NSH_PROMPT_STRING="nsh> "
CONFIG_NSH_PROMPT_MAX=32
CONFIG_NSH_PROMPT_ENV="PS1"
CONFIG_NSH_PROMPT_SUFFIX="> "
CONFIG_NSH_READLINE=y
CONFIG_NSH_LINELEN=256
CONFIG_NSH_QUOTE=y
CONFIG_NSH_MAXARGUMENTS=7
CONFIG_NSH_ARGCAT=y
CONFIG_NSH_NESTDEPTH=3
CONFIG_NSH_ALIAS=y
CONFIG_NSH_ALIAS_MAX_AMOUNT=1
CONFIG_NSH_PIPELINE=y
CONFIG_NSH_BUILTIN_APPS=y
CONFIG_NSH_FILE_APPS=y
CONFIG_NSH_DISABLE_DATE=y
CONFIG_NSH_DISABLE_LOSMART=y
CONFIG_NSH_DISABLE_LOMTD=y
CONFIG_NSH_DISABLE_MB=y
CONFIG_NSH_DISABLE_MH=y
CONFIG_NSH_DISABLE_MW=y
CONFIG_NSH_DISABLE_SHUTDOWN=y
CONFIG_NSH_DISABLE_TIMEDATECTL=y
CONFIG_NSH_CODECS_BUFSIZE=128
CONFIG_NSH_PROC_MOUNTPOINT="/proc"
CONFIG_NSH_FILEIOSIZE=1024
CONFIG_NSH_SYSINITSCRIPT="init.d/rc.sysinit"
CONFIG_NSH_INITSCRIPT="init.d/rcS"
CONFIG_NSH_SCRIPT_REDIRECT_PATH=""
CONFIG_NSH_CONSOLE=y
CONFIG_NSH_ARCHINIT=y
CONFIG_NSH_NETINIT=y
CONFIG_NSH_WGET_BUFF_SIZE=512
CONFIG_CONTEST2026_062_NYABULA_CORE=y
CONFIG_NYABULA_CORE_EYE=y
CONFIG_NYABULA_CORE_WAMR=y
CONFIG_NYABULA_CORE_WEB=y
CONFIG_NYABULA_CORE_WEB_EYEPROBE=y
CONFIG_NYABULA_CORE_WEB_PORT=80
CONFIG_NYABULA_CORE_WEB_TOKEN_PATH="/config/nyabula/web.token"
CONFIG_NYABULA_CORE_WEB_AUTH_PATH="/config/nyabula/web.auth"
CONFIG_NYABULA_CORE_WEB_ROOT="/data/www"
CONFIG_NYABULA_CORE_HTTP=y
CONFIG_NYABULA_CORE_PRIORITY=100
CONFIG_NYABULA_CORE_BACKGROUND_PRIORITY=80
CONFIG_NYABULA_CORE_STACKSIZE=32768
CONFIG_NYABULA_CORE_PLUGIN_MEMORY=8388608
CONFIG_NYABULA_CORE_PLUGIN_STACK=262144
CONFIG_NYABULA_CORE_EVENT_TIMEOUT_MS=100
CONFIG_NYABULA_CORE_ASYNC_TIMEOUT_MS=15000
CONFIG_NYABULA_CORE_EVENTS_PER_MINUTE=120
CONFIG_NYABULA_CORE_MAX_EVENTS_PER_MINUTE=600
CONFIG_NYABULA_CORE_SOURCE_LIMIT=1048576
CONFIG_NYABULA_CORE_MANIFEST_LIMIT=16384
CONFIG_NYABULA_CORE_REQUIRE_SIGNATURE=y
CONFIG_NYABULA_CORE_TRUST_STORE="/host/trusted-keys.json"
CONFIG_NYABULA_CORE_GRANT_STORE="/host/grants.json"
CONFIG_NYABULA_CORE_PACKAGE_STORE="/host/apps"
CONFIG_NYABULA_CORE_HEALTH_STORE="/host/health"
CONFIG_NYABULA_CORE_REVOCATION_STORE="/host/revocations.json"
CONFIG_NYABULA_CORE_QUARANTINE_FAILURES=3
CONFIG_NYABULA_CORE_PACKAGE_FILE_LIMIT=128
CONFIG_NYABULA_CORE_PACKAGE_SIZE_LIMIT=8388608
CONFIG_NYABULA_CORE_MAX_PLUGINS=4
CONFIG_NYABULA_CORE_MAX_BACKGROUND_PLUGINS=2
CONFIG_NYABULA_CORE_EVENT_DEPTH=8
CONFIG_NYABULA_CORE_STORAGE_VALUE_LIMIT=4096
CONFIG_NYABULA_CORE_AI_RESPONSE_LIMIT=4096
CONFIG_NYABULA_CORE_STATE_SQLITE=y
CONFIG_NYABULA_CORE_STATE_DATABASE="/host/nyabula-product.sqlite"
CONFIG_NYABULA_CORE_PRODUCT=y
CONFIG_NYABULA_CORE_MODELS=y
CONFIG_NYABULA_CORE_MEDIA=y
CONFIG_NYABULA_CORE_MEDIA_ROOT="/host/media"
CONFIG_NYABULA_CORE_MEDIA_DEVICE="/dev/audio/pcm_test"
CONFIG_NYABULA_CORE_STORAGE_BYTES_LIMIT=65536
CONFIG_NYABULA_CORE_STORAGE_KEYS_LIMIT=64
CONFIG_NYABULA_CORE_JOB_LIMIT=256
CONFIG_SYSTEM_DUMPSTACK=y
CONFIG_SYSTEM_DUMPSTACK_STACKSIZE=2048
CONFIG_SYSTEM_DUMPSTACK_PRIORITY=100
CONFIG_SYSTEM_NSH=y
CONFIG_SYSTEM_NSH_PRIORITY=100
CONFIG_SYSTEM_NSH_STACKSIZE=2048
CONFIG_SYSTEM_NSH_PROGNAME="nsh"
CONFIG_SYSTEM_NXPLAYER=y
CONFIG_NXPLAYER_MAINTHREAD_STACKSIZE=2048
CONFIG_NXPLAYER_PLAYTHREAD_STACKSIZE=16384
CONFIG_NXPLAYER_COMMAND_LINE=y
CONFIG_NXPLAYER_INCLUDE_HELP=y
CONFIG_NXPLAYER_INCLUDE_DEVICE_SEARCH=y
CONFIG_NXPLAYER_INCLUDE_PREFERRED_DEVICE=y
CONFIG_NXPLAYER_FMT_FROM_EXT=y
CONFIG_NXPLAYER_INCLUDE_MEDIADIR=y
CONFIG_NXPLAYER_DEFAULT_MEDIADIR="/music"
CONFIG_SYSTEM_POPEN=y
CONFIG_SYSTEM_POPEN_STACKSIZE=2048
CONFIG_SYSTEM_POPEN_PRIORITY=100
CONFIG_SYSTEM_READLINE=y
CONFIG_READLINE_HAVE_EXTMATCH=y
CONFIG_READLINE_ECHO=y
CONFIG_READLINE_TABCOMPLETION=y
CONFIG_READLINE_MAX_BUILTINS=64
CONFIG_READLINE_MAX_EXTCMDS=64
CONFIG_SYSTEM_SYSTEM=y
CONFIG_SYSTEM_SYSTEM_STACKSIZE=2048
CONFIG_SYSTEM_SYSTEM_PRIORITY=100
CONFIG_TESTING_OSTEST=y
CONFIG_TESTING_OSTEST_LOOPS=1
CONFIG_TESTING_OSTEST_PRIORITY=150
CONFIG_TESTING_OSTEST_STACKSIZE=8192
CONFIG_TESTING_OSTEST_NBARRIER_THREADS=8
CONFIG_TESTING_OSTEST_RR_RANGE=30000
CONFIG_TESTING_OSTEST_RR_RUNS=10
CONFIG_TESTING_OSTEST_WAITRESULT=y
CONFIG_TESTING_OSTEST_SPINLOCK_THREADS=2
CONFIG_TEST_LOOP_SCALE=100
CONFIG_ARCH_BOARD_CUSTOM=y
CONFIG_ARCH_BOARD_CUSTOM_NAME="sim"
CONFIG_ARCH_BOARD_CUSTOM_DIR="boards/sim/sim/sim"
CONFIG_ARCH_BOARD_CUSTOM_DIR_RELPATH=y

# Headless tests use the fake audio driver, not host ALSA.
# CONFIG_SIM_SOUND is not set
CONFIG_EXAMPLES_EYEPROBE=y
CONFIG_NYABULA_CORE_EVENT_SIZE=4096
```
