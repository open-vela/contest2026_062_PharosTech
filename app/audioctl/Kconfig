## boards/rk3576/kickpi-k7/Kconfig
```kconfig
#
# KICKPI-K7 (RK3576) board (out-of-tree vendor board)
#
config ARCH_BOARD_KICKPI_K7
	bool
	default y

if ARCH_BOARD_KICKPI_K7

config KICKPI_K7_LITCORE_CPU_FREQ_SET
	bool "Set LITTLE-core CPU frequency at boot"
	default n
	---help---
		Enable a one-shot LITTLE-core (litcore) CPU frequency configuration
		during board_late_initialize(), applied once after the clock tree is
		initialized and before peripheral clocks that depend on the final
		CPU rate are started.

		Disable this option to skip the frequency change entirely and keep
		the bootloader-configured CPU rate.

config KICKPI_K7_LITCORE_CPU_FREQ_MHZ
	int "LITTLE-core CPU boot frequency (MHz)"
	default 1800
	range 96 2400
	depends on KICKPI_K7_LITCORE_CPU_FREQ_SET
	---help---
		Boot-time LITTLE-core (litcore) CPU frequency, in MHz.  Applied once
		during board_late_initialize() via rk3576_clk_set_litcore_cpufreq()
		after the clock tree is initialized.  Only the standard RK3576 LPLL
		gears are accepted (96, 216, 312, 408, 600, 816, 1008, 1200, 1320,
		1392, 1416, 1440, 1464, 1488, 1512, 1536, 1560, 1584, 1608, 1704,
		1800, 1896, 1992, 2016, 2040, 2088, 2184, 2208, 2304, 2400); any
		other value is rejected at runtime (and at compile time via a
		static assert) and the bootloader-configured rate is kept.

		The full 96..2400 MHz range is the LPLL's supported output span, and
		all of these gears are retained so that parts capable of higher
		frequencies (better silicon / higher OPP voltage) can use them.
		Whether a given gear is actually stable on this board depends on the
		individual CPU's silicon quality and supply voltage and is up to the
		user to validate.

		This is a one-shot, non-DVFS setting: it reprograms LPLL and
		normalizes the CPU source divider, but does NOT re-scale the
		dependent bus dividers (aclk_m_litcore / pclk_dbg_litcore / CCI) nor
		change the regulator OPP voltage, as a full DVFS transition would.

config KICKPI_K7_WIFI
	bool "On-board SeekWave SV6621 WiFi/BT combo"
	default n
	depends on RK3576_SDIO && KICKPI_K7_RTC
	select SV6621
	select DEV_GPIO if SV6621_PM
	---help---
		Configure the KICKPI-K7 pin environment, power sequence and firmware
		images for the on-board SV6621.  The combo's 32.768 kHz sleep clock
		is sourced from the on-board PCF8563/HYM8563TS RTC CLKOUT (see
		KICKPI_K7_RTC), so this option requires the RTC driver.

config KICKPI_K7_WIFI_IRAM
	string "SV6621 IRAM firmware image"
	default "SWT6621S_IRAM_SDIO.bin"
	depends on KICKPI_K7_WIFI

config KICKPI_K7_WIFI_DRAM
	string "SV6621 DRAM firmware image"
	default "SWT6621S_DRAM_SDIO.bin"
	depends on KICKPI_K7_WIFI

config KICKPI_K7_WIFI_NV
	string "SV6621 NV configuration image"
	default "SWT6621S_NV_SDIO_ALONE.bin"
	depends on KICKPI_K7_WIFI

config KICKPI_K7_WIFI_CALIB
	string "SV6621 RF calibration image"
	default "SWT6621S_SEEKWAVE_R00001.bin"
	depends on KICKPI_K7_WIFI

config KICKPI_K7_BLUETOOTH
	bool "On-board SeekWave SV6621 Bluetooth"
	default n
	depends on KICKPI_K7_WIFI
	select SV6621_BLUETOOTH
	---help---
		Start the Bluetooth service in the on-board combo, download its NVDS
		calibration records and register /dev/ttyHCI0 for Fluoride.

config KICKPI_K7_BLUETOOTH_NV
	string "SV6621 Bluetooth NVDS image"
	default "sv6160lite.nvbin"
	depends on KICKPI_K7_BLUETOOTH

config KICKPI_K7_AUDIO
	bool "On-board ES8388 audio (SAI1 + I2C3)"
	default n
	depends on RK3576_SAI && RK3576_I2C
	select AUDIO_ES8388
	select AUDIO_FORMAT_PCM
	---help---
		Register the on-board Everest ES8388 codec (I2C3 @ 0x10) driven by
		the SAI1 I2S controller as the PCM audio device /dev/audio/pcm0.
		Muxes the SAI1 MCLK/SCLK/LRCK/SDO0/SDI0 pins at boot.

config KICKPI_K7_STORAGE_AUTOMOUNT
	bool "Automatic removable and on-board storage mounting"
	default n
	depends on FS_FAT && FS_TMPFS && GPT_PARTITION
	depends on SCHED_WORKQUEUE && SCHED_LPWORK
	depends on RK3576_SDMMC || RK3576_EMMC
	---help---
		Discover supported FAT data volumes without formatting media.  Prefer
		a usable eMMC data volume for /data, fall back to SD, and handle SD
		card insertion and removal.  /tmp remains a safe tmpfs; persistent
		temporary storage is published as /tmp/persist when /data is mounted.

choice
	prompt "Default audio output route"
	default KICKPI_K7_AUDIO_OUTPUT_AUTO
	depends on KICKPI_K7_AUDIO

config KICKPI_K7_AUDIO_OUTPUT_AUTO
	bool "Automatic (headphones take priority)"

config KICKPI_K7_AUDIO_OUTPUT_HEADPHONES
	bool "Headphones only"

config KICKPI_K7_AUDIO_OUTPUT_SPEAKER
	bool "Speaker only"

config KICKPI_K7_AUDIO_OUTPUT_BOTH
	bool "Headphones and speaker"

config KICKPI_K7_AUDIO_OUTPUT_OFF
	bool "All outputs off"

endchoice

config KICKPI_K7_RTC
	bool "On-board PCF8563 / HYM8563TS RTC (I2C2)"
	default n
	depends on RTC_PCF8563 && RK3576_I2C
	---help---
		Register the on-board HYM8563TS (PCF8563-compatible) real-time
		clock on I2C2 as /dev/rtc0.  Muxes the I2C2 SCL (GPIO0_B7) and SDA
		(GPIO0_C0) pins to alternate function 9 at boot.

config KICKPI_K7_LCD
	bool "ST77916 LCD panel over FSPI1 (hardware modification)"
	default n
	depends on RK3576_FSPI && LCD_ST77916 && LCD_DEV && RK3576_PWM
	---help---
		Enable the ST77916 LCD panel connected via FSPI1 CS0 (QSPI).
		This is not part of the stock kickpi-k7 board; it requires a
		hardware modification where the FSPI1 pins (shared with the SD
		card slot) are repurposed for the display.  The SD card must be
		removed before using the panel.

		The display backlight (GPIO2_D7 -> PWM2 CH7) is registered as
		/dev/pwm0 for user-layer control (active-low: HIGH = off).

config KICKPI_K7_WDT
	bool "On-chip Watchdog Timer (WDT_NS)"
	default n
	depends on RK3576_WDT
	---help---
		Register the RK3576 non-secure on-chip watchdog timer (WDT_NS,
		0x2ACE0000, fixed 24 MHz) as /dev/watchdog0 in
		board_late_initialize().  NuttX upper-half (CONFIG_WATCHDOG)
		then allows the kernel auto-monitor and/or user space to control
		it.

		WDT_NS is the natural watchdog for the NuttX kernel/user space:
		its counting clock is a fixed 24 MHz, and it has no pclk/tclk
		clock gate, so it needs no staging by software.  The rk3576_wdt
		driver currently implements only this non-secure instance (the
		SoC also exposes a PMU-domain WDT, but that one is not supported
		by the driver yet).

config KICKPI_K7_USBHOST
	bool "Three-port USB-A host"
	default n
	depends on RK3576_USBHOST && RK3576_GPIO
	select USBHOST_MSC
	select USBHOST_HIDKBD
	select USBHOST_HIDMOUSE
	---help---
		Enable GPIO3_D6 VBUS and initialize USB1 xHCI for the on-board
		GL3510 SuperSpeed hub and the three external USB-A ports.

config KICKPI_K7_CAMERA
	bool "On-board MIPI CSI camera (OV5647 on CSI0)"
	default n
	depends on RK3576_MIPI_CSI && RK3576_VICAP && RK3576_I2C && RK3576_GPIO
	depends on VIDEO_OV5647
	---help---
		Bring up the OV5647 camera module on the CSI0 connector and expose
		the capture path as /dev/video0.

		CSI0 is the one connector fed by the DCPHY's RX (slave) lanes --
		CSI1 and CSI3 go through the separate CSIDPHY0/1, which this
		build does not support yet.  The module is wired straight through
		to the SoC on the 22-pin FFC: there is no power-enable or reset
		line on the connector, and the module carries its own 25 MHz
		oscillator, so the SoC supplies neither a master clock nor a
		reset.  One SoC GPIO (GPIO0_D2) does gate the module.

		The sensor's control bus is I2C4 in its M3 pin multiplexing
		(SCL GPIO3_C0, SDA GPIO3_B7, both at alternate function 11).

		All seven of the sensor's capture modes are reachable.  The board
		is told which one a stream wants before the camera is opened, and
		moves the D-PHY, the CSI HOST and its capture engine to match; see
		kickpi_k7_camera_set_mode().  Boot brings the chain up on
		OV5647_MODE_DEFAULT, and that is only a placeholder -- the capture
		engine has no scaler, so a device node needs some geometry, and the
		first request replaces it.

config KICKPI_K7_ETHERNET
	bool "On-board dual Gigabit Ethernet (GMAC0 + GMAC1)"
	default n
	depends on RK3576_GMAC && RK3576_GPIO
	select ETH_PHY_MAE0621A
	---help---
		Bring up the two on-board RJ45 ports, each behind its own Maxio
		MAE0621A gigabit PHY.

		Two descriptions of the part live in kickpi_k7_ethernet.c, and
		they are for different consumers: a struct phy_desc_s, which is
		NuttX's own way of naming a PHY and is what the MAC driver's
		probe and address walk use, and a struct ethernet_phy_s, which is
		what the PHY driver in drivers/drivers/ethernet_phy runs on.  This
		file is the only place that sees both, which is why the chip and
		the driver trees never include each other.

		  GMAC0 (0x2a220000) -- MAE0621A -- RJ45
		  GMAC1 (0x2a230000) -- MAE0621A -- RJ45

		This is a board function, not a peripheral that has to be added:
		both PHYs are populated on every revision of the board.

		The pin sets are disjoint -- GMAC0 on GPIO bank 3 at alternate
		function 3 (the eth0m0 group), GMAC1 on bank 2 at function 2
		(eth1m0) -- which is what makes two instances safe at the pinmux
		level.  The PHY reset lines are crossed with respect to the data
		pins: GMAC0's data is on bank 3 but its reset is GPIO2_B5, and
		GMAC1's is the other way round (GPIO3_A3).

		Both ports are RGMII with the TXC driven by the SoC
		(clock_in_out = "output") and the PHY adding the RX delay in its
		own pins (rgmii-rxid).  That is a fact rather than a preference:
		the PHYs are strapped TXDLY = 0, RXDLY = 1, and the resistors
		that would have fed the PHY's 125 MHz CLKOUT back to the SoC are
		marked NC and unpopulated.  So the SoC supplies the TX delay and
		must leave its RX delay off, or the delay is counted twice.

if KICKPI_K7_ETHERNET

config KICKPI_K7_ETHERNET_PORT1
	bool "Also bring up the second port (GMAC1)"
	default y
	---help---
		Register the second RJ45 as well.  Turning this off leaves only
		GMAC0, which is useful when only one port's PHY is suspected: it
		halves the network buffers the driver holds.

config KICKPI_K7_ETHERNET_TX_DELAY0
	int "GMAC0 RGMII TX delay (taps, 1/8 ns each)"
	default 33
	range 0 127
	---help---
		The tx_delay the vendor DTB specifies for ethernet@2a220000: 0x21,
		i.e. 33 taps of the VCCIO TX clock delay line.  A number here, not
		a register write somewhere in the driver, so that retiming a board
		is a rebuild and not an edit.

		The PHY's own TXDLY strap is 0 on this board, so this is the only
		TX delay in the path.  If the link trains at gigabit but loses
		frames, this is the first number to move.

config KICKPI_K7_ETHERNET_TX_DELAY1
	int "GMAC1 RGMII TX delay (taps, 1/8 ns each)"
	default 32
	range 0 127
	---help---
		The tx_delay the vendor DTB specifies for ethernet@2a230000: 0x20,
		i.e. 32 taps.  One tap less than port 0, which is what the vendor
		DTB says and not a transcription error.

choice
	prompt "PHY MDI pairing, GMAC0"
	default KICKPI_K7_ETHERNET_MDI0_AUTO
	---help---
		How the PHY's twisted pairs are paired.  Left to the part, its own
		crossover detection picks MDI or MDIX; forced, the board is paired
		one way and stays that way.

		Automatic is right for a normal deployment.  Forcing is the way to
		test a pairing hypothesis: a straight cable needs one end MDI and
		the other MDIX, and two identical endpoints (two NICs, or two
		boards) are both MDI.

config KICKPI_K7_ETHERNET_MDI0_AUTO
	bool "automatic (the PHY decides)"

config KICKPI_K7_ETHERNET_MDI0_MDI
	bool "force MDI"

config KICKPI_K7_ETHERNET_MDI0_MDIX
	bool "force MDIX (as a switch port is paired)"

endchoice

choice
	prompt "PHY MDI pairing, GMAC1"
	default KICKPI_K7_ETHERNET_MDI1_AUTO
	---help---
		Same choice for the second port.  The two are separate so that one
		flash can pair the two ports against each other: cable them
		together with one forced MDI and the other forced MDIX and a
		straight cable is then correctly paired.

config KICKPI_K7_ETHERNET_MDI1_AUTO
	bool "automatic (the PHY decides)"

config KICKPI_K7_ETHERNET_MDI1_MDI
	bool "force MDI"

config KICKPI_K7_ETHERNET_MDI1_MDIX
	bool "force MDIX (as a switch port is paired)"

endchoice

config KICKPI_K7_ETHERNET_MACADDR0
	string "GMAC0 MAC address"
	default "02:52:4b:37:76:00"
	---help---
		The address programmed into MAC address register 0 of GMAC0.

		Nothing on this board supplies one: the vendor DTB sets no
		mac-address, no nvmem-cells and no local-mac-address on either
		ethernet node, and the RK3576 GMAC has no OTP MAC.  So the board
		states it.  The default is locally administered (the 0x02 bit) and
		unique per port; give each board its own if several share a
		segment.

config KICKPI_K7_ETHERNET_MACADDR1
	string "GMAC1 MAC address"
	default "02:52:4b:37:76:01"
	depends on KICKPI_K7_ETHERNET_PORT1
	---help---
		The address programmed into MAC address register 0 of GMAC1.

endif # KICKPI_K7_ETHERNET

choice
	prompt "kickpi-k7 primary display output"
	default KICKPI_K7_MIPI_DSI
	depends on RK3576_VOP && RK3576_GPIO
	---help---
		Select which display output this board brings up at boot.

		Only ONE may be selected.  This is not a hardware limit: the RK3576
		VOP has three independent video ports, and HDMI and MIPI DSI share
		no register at all (they do not even share a PHY -- the HDPTX combo
		PHY is shared with eDP, while DSI has its own DCPHY).  The limit is
		in rk3576_vop.c, which currently drives a single output instance:
		one global framebuffer handle, and ESMART0 plus video port 0 wired
		in unconditionally.  A second output would take over the first
		one's layer and video port.

		Making the choice explicit means a misconfiguration is caught at
		configure time instead of two drivers silently fighting at boot.
		kickpi_k7_video_initialize() also refuses a second claim at
		runtime as a backstop.

config KICKPI_K7_MIPI_DSI
	bool "MIPI DSI LCD panel (DCPHY + DSI-2 + VOP)"
	depends on RK3576_MIPI_DCPHY
	depends on RK3576_MIPI_DSI
	depends on RK3576_PWM
	---help---
		Wire up the on-board MIPI DSI LCD panel: configure the panel control
		pins (reset / power-enable) and backlight PWM, bring up the RK3576
		DCPHY + DSI-2 host, send the panel DCS init sequence, register the
		VOP framebuffer (/dev/fbN), then switch the host into video mode
		and turn the backlight on.

		The VOP must be started BEFORE the host enters video mode, because
		entering video mode starts the IPI timing generator counting lines
		against the pixel clock.

config KICKPI_K7_HDMI
	bool "HDMI output (HDMI TX + HDPTX PHY, DVI/TMDS 1080p60)"
	depends on RK3576_HDPTXPHY
	depends on RK3576_HDMI
	depends on RK3576_GPIO
	---help---
		Bring up the HDMI output in DVI mode over TMDS at 1080p60: the
		DesignWare HDMI QP transmitter, the HDPTX PHY and its TMDS PLL, and
		the VOP framebuffer that feeds the transmitter over the IPI.

		The VOP must be started AFTER the PHY, because on this path the
		PHY's own PLL -- not the CRU -- generates the pixel clock, and the
		video port is reparented straight onto it.  Starting the VOP first
		would leave the video port with no clock at all.

		DVI mode only: no infoframes, no audio, no HDCP, no SCDC
		scrambling and no HDMI 2.1 FRL, so a sink that requires any of
		those will show nothing.
endchoice

config KICKPI_K7_VIDEO
	bool
	default y if KICKPI_K7_MIPI_DSI || KICKPI_K7_HDMI
	---help---
		Derived symbol: set whenever this board brings up a display output,
		i.e. whenever one of the two choice entries above is selected.

		It exists so that the build and the shared VOP layer can test one
		unambiguous symbol instead of an OR of the two, which is what would
		otherwise have to be spelled out (and kept in sync) in the Makefile,
		in CMakeLists.txt and in the kickpi_k7_video.c preprocessor guard.

choice
	prompt "kickpi-k7 panel mounting orientation"
	default KICKPI_K7_PANEL_ORIENT_180
	depends on KICKPI_K7_MIPI_DSI
	---help---
		Which way round the panel module is mounted in the enclosure,
		relative to the orientation its vendor reference describes.  The
		vendor's DCS init sequence and its GT911 configuration table are
		both written for that reference, and this board's enclosure holds
		the module 180 degrees from it, so both ends have to be corrected.

		One setting, because there is one physical fact: the picture and
		the coordinates are two views of the same glass.  Setting it here
		rather than in the display code and the touch driver separately is
		the point -- the two are read by kickpi_k7_mipi_dsi.c (the panel's
		MADCTL scan-direction bits) and by kickpi_k7_touch.c (the GT911
		driver's coordinate transform) through the two derived symbols
		below, so they cannot drift apart.

		Only the four orientations that both ends can actually express are
		offered.  The panel has no frame memory and its MADCTL (36h) has
		only SS and GS -- there is no MV/MX/MY as on a generic MIPI DCS
		panel -- so clearing or setting those two bits is a mirror of one
		axis each and two of them are a 180 degree rotation.  A quarter
		turn is not expressible at all: the panel's pixel grid stays
		720 x 1280 however it is scanned, so landscape needs the framebuffer
		rotated (which is an application/compositor matter, LVGL included)
		and would additionally want the touch axes swapped, which
		gt911_register() can already express.

		HDMI is unaffected: it has no MADCTL of its own to set, so a sink's
		orientation is the sink's business.

config KICKPI_K7_PANEL_ORIENT_0
	bool "0 degrees (the vendor reference orientation)"
	---help---
		The module is mounted the way the vendor's reference describes:
		the display's scan directions keep the values the vendor's init
		sequence uses and the touch coordinates are reported as they are.

config KICKPI_K7_PANEL_ORIENT_MIRROR_X
	bool "Mirrored horizontally"
	---help---
		The module is mounted with its horizontal axis reversed (flipped
		about the vertical axis): the picture is mirrored left to right and
		the touch coordinates are mirrored on their X axis.

config KICKPI_K7_PANEL_ORIENT_MIRROR_Y
	bool "Mirrored vertically"
	---help---
		The module is mounted with its vertical axis reversed (flipped
		about the horizontal axis): the picture is mirrored top to bottom
		and the touch coordinates are mirrored on their Y axis.

config KICKPI_K7_PANEL_ORIENT_180
	bool "180 degrees (module mounted upside down)"
	---help---
		The module is mounted the other way up from the vendor reference,
		which is what this board's enclosure does: the picture is rotated
		180 degrees on the glass and the touch coordinates are mirrored on
		both axes.

		This is the measured, working setting.  It is the default so that a
		configuration which says nothing about the orientation still comes
		up with the display and the touchscreen agreeing.
endchoice

config KICKPI_K7_PANEL_MIRROR_X
	bool
	default y if KICKPI_K7_PANEL_ORIENT_MIRROR_X || KICKPI_K7_PANEL_ORIENT_180
	---help---
		Derived symbol: the picture and the coordinates both have to be
		mirrored on the X axis relative to the vendor reference.

		This is what the two consumers read -- kickpi_k7_mipi_dsi.c inverts
		the panel's source-scan bit (SS) for it, kickpi_k7_touch.c sets
		mirrorx in struct gt911_orientation_s -- so "which axes are
		reversed" is decided once, here, instead of in each driver.

config KICKPI_K7_PANEL_MIRROR_Y
	bool
	default y if KICKPI_K7_PANEL_ORIENT_MIRROR_Y || KICKPI_K7_PANEL_ORIENT_180
	---help---
		Derived symbol: the picture and the coordinates both have to be
		mirrored on the Y axis relative to the vendor reference.  See
		KICKPI_K7_PANEL_MIRROR_X; this one is the panel's gate-scan bit (GS)
		and the touch driver's mirrory.

config KICKPI_K7_TOUCH
	bool "On-board Goodix GT911 touch panel (I2C0 M1)"
	default n
	depends on KICKPI_K7_MIPI_DSI
	depends on INPUT_GT911
	---help---
		Register the capacitive touch controller that sits on the same
		module as the MIPI DSI panel as /dev/input0, driven by the platform
		GT911 driver (CONFIG_INPUT_GT911).

		This muxes the I2C0 SCL (GPIO0_C1) and SDA (GPIO0_C2) pins to
		alternate function 9, brings up the I2C0 controller, resets the
		controller and registers the touchscreen framework device.  The
		controller's INT pin (GPIO0_C5) is wired as an interrupt and RST
		(GPIO0_D0) as the reset line.

		The panel supply is shared with the display, so this is tied to the
		MIPI DSI output -- the DSI bring-up powers the module first and then
		calls into the touch bring-up (see kickpi_k7_mipi_dsi.c).

		The controller is consumed by LVGL through LV_USE_NUTTX_TOUCHSCREEN
		(default input path /dev/input0); no additional application-side
		wiring is needed.

choice
	prompt "On-board GT911 touch module configuration table"
	default KICKPI_K7_TOUCH_CFG_VENDOR
	depends on KICKPI_K7_TOUCH
	---help---
		The GT911 keeps its sensing configuration (X/Y output range,
		contact limit, sensing channel map, drive frequency, gains) in
		its own non-volatile memory.  A module can be delivered with that
		area blank -- it answers on I2C and senses nothing at all, because
		with no output range and no channel map it never scans, never
		reports a frame and never raises INT, which is indistinguishable
		from a driver fault.  A table exists here for that case, exactly as
		the vendor's own driver has one (its device trees carry it in
		goodix,cfg-group0 and flash it on every probe).

		The module on this board turned out to be programmed already: it
		reports version 0x49, a 720 x 1280 range and 5 contacts, i.e. the
		table below, and the driver therefore leaves it alone.  What made
		this board's touchscreen look dead was not a blank configuration at
		all but the reset sequence -- the controller answers on I2C without
		its sensing engine ever starting unless INT is held low for 50 ms
		after reset, which is what both mainline and Goodix's own driver do.
		See kickpi_k7_touch.c.

		The driver writes the selected table only when the controller
		reports no usable configuration of its own, so a module that has
		already been programmed -- at the factory, or by the vendor's
		driver -- is left alone.  CONFIG_INPUT_GT911_CONFIG_FORCE
		overrides that.

		Note that the controller stores only one configuration and refuses
		a version lower than the one it holds, so a table with a higher
		version number locks out every lower one.  That is why the vendor
		table (version 0x49) has to be applied to a blank module first.

config KICKPI_K7_TOUCH_CFG_NONE
	bool "None (leave the module's own configuration alone)"
	---help---
		Do not download anything.  Right for a module that is already
		programmed, and the way to check what a module reports about
		itself without changing it.

config KICKPI_K7_TOUCH_CFG_VENDOR
	bool "Panel vendor table, 720 x 1280, 5 contacts (version 0x49)"
	---help---
		The panel vendor's own configuration for this module, supplied as
		"GT911_Config_720X1280_0x49" (2025-11-05).

		Its X/Y output range is 720 x 1280 -- the same frame as the
		display, so the reported coordinates need no rescaling -- and its
		0x804d value has the axis-exchange bit set, which means the
		controller does that swap internally.  The touch driver's own
		axis swap therefore stays off, and the only correction left to make
		is the module's mounting, which is what
		KICKPI_K7_PANEL_ORIENTATION decides for this end and for the
		picture at the same time.

		This is the table to use.

		The board's Debian image also carries four goodix,cfg-group0
		tables in its Linux device trees, but each belongs to a different
		panel variant (800 x 1280 frames, one with the axes exchanged for
		its landscape panel) rather than to this module, and the
		controller's version check makes a wrong table awkward to undo --
		a table with a higher version number permanently locks out every
		lower one.  They are therefore deliberately not shipped here; the
		numbers are recorded in the repository's notes if they are ever
		needed.

config KICKPI_K7_TOUCH_CFG_ALTERNATES
	bool "Also try the vendor's other configuration tables"
	default y
	depends on KICKPI_K7_TOUCH_CFG_VENDOR
	---help---
		Try the tables the vendor ships in their Linux device trees after
		the one they supplied for this module.

		The vendor has one table per panel variant, and the panel whose
		init sequence matches this board's panel is paired with an
		800 x 1280 sensor table in those device trees (with its touch
		node enabled) rather than with the 720 x 1280 table handed to us
		separately.  Since a configuration describes the touch sensor --
		its channel map, frequency and gains -- and only the vendor can
		attribute a sensor to a module, the table that matches is worth
		letting the driver find rather than assuming.

		Trying a table costs nothing here: this module does not retain a
		configuration across a reset, so no version ordering can be locked
		in by an attempt, and the driver reports a table as correct only
		when the controller's sensing engine starts reporting a
		coordinate range -- never merely because the write verified.

endchoice

endif # ARCH_BOARD_KICKPI_K7
```
