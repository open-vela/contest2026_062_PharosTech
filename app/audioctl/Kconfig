## configs/product/defconfig
```kconfig
#
# Nyabula KICKPI-K7 product configuration (main openvela domain).
#
# Union of configs/dev (WiFi/BT/audio/USB/ADB) and configs/core_eye
# (dual LCD, Eye Engine, Nyabula Core) plus the native product services,
# the official ai_agent (Nyabot), SoftAP provisioning helpers and RPTUN
# for the AMP compute domain. Stores live under /data, not /tmp.
#
# Build (openvela workspace root):
#   ./build.sh contest2026_062_PharosTech/configs/product -j8
#
CONFIG_ARCH="arm64"
CONFIG_ARCH_ARM64=y
CONFIG_ARCH_SETJMP_H=y
CONFIG_ARCH_CHIP_ARM64_CUSTOM=y
CONFIG_ARCH_CHIP_CUSTOM=y
CONFIG_ARCH_CHIP_CUSTOM_DIR="../vendor/rockchip/chips/rk3576"
CONFIG_ARCH_CHIP_CUSTOM_DIR_RELPATH=y
CONFIG_ARCH_CHIP_CUSTOM_NAME="rk3576"
CONFIG_ARCH_BOARD_CUSTOM=y
CONFIG_ARCH_BOARD_CUSTOM_DIR="../vendor/rockchip/boards/rk3576/kickpi-k7"
CONFIG_ARCH_BOARD_CUSTOM_DIR_RELPATH=y
CONFIG_ARCH_BOARD_CUSTOM_NAME="kickpi-k7"
CONFIG_ARCH_EARLY_PRINT=y
CONFIG_ARCH_INTERRUPTSTACK=4096
CONFIG_ARCH_IRQPRIO=y
CONFIG_ARM64_GIC_VERSION=2
CONFIG_BOARDCTL_RESET=y
CONFIG_BOARDCTL_IOCTL=y
CONFIG_BOARDCTL_USBDEVCTRL=y
CONFIG_BOARD_LOOPSPERMSEC=116524
CONFIG_BOARD_LATE_INITIALIZE=y
CONFIG_BUILTIN=y
CONFIG_DEBUG_ASSERTIONS=y
CONFIG_DEBUG_FEATURES=y
CONFIG_DEBUG_FULLOPT=y
CONFIG_DEBUG_SYMBOLS=y
CONFIG_DEFAULT_TASK_STACKSIZE=8192
CONFIG_EXPERIMENTAL=y
CONFIG_FRAME_POINTER=y
CONFIG_HAVE_CXX=y
CONFIG_HAVE_CXXINITIALIZE=y
CONFIG_IDLETHREAD_STACKSIZE=8192
CONFIG_INIT_ENTRYPOINT="nsh_main"
CONFIG_MM_REGIONS=2
CONFIG_PIPES=y
CONFIG_PREALLOC_TIMERS=4
CONFIG_PM=y
CONFIG_PTHREAD_MUTEX_TYPES=y
CONFIG_PTHREAD_STACK_MIN=8192
CONFIG_RAMLOG=y
CONFIG_RAM_SIZE=136314880
CONFIG_RAM_START=0x40200000
CONFIG_RAW_BINARY=y
CONFIG_READLINE_CMD_HISTORY=y
CONFIG_RR_INTERVAL=200
CONFIG_SCHED_BACKTRACE=y
CONFIG_SCHED_CHILD_STATUS=y
CONFIG_SCHED_HAVE_PARENT=y
CONFIG_SCHED_HPWORK=y
CONFIG_SCHED_HPWORKPRIORITY=192
CONFIG_SCHED_LPWORK=y
CONFIG_SCHED_WORKQUEUE=y
CONFIG_SPINLOCK=y
CONFIG_STACK_COLORATION=y
CONFIG_START_MONTH=11
CONFIG_START_YEAR=2022
CONFIG_SYMTAB_ORDEREDBYNAME=y
CONFIG_SYSTEM_TIME64=y
CONFIG_TLS_NELEM=4
CONFIG_TLS_TASK_NELEM=4
CONFIG_UART0_BAUD=1500000
CONFIG_UART0_SERIAL_CONSOLE=y
CONFIG_USEC_PER_TICK=1000

#
# C/C++ runtime
#
CONFIG_LIBC_EXECFUNCS=y
CONFIG_LIBC_FLOATINGPOINT=y
CONFIG_LIBCXX=y
CONFIG_LIBCXXABI=y
CONFIG_CXX_MINI_LOCALIZATION=y
CONFIG_CXX_WCHAR=y
CONFIG_PSEUDOTERM=y

#
# Shell and system tools
#
CONFIG_NSH_ARCHINIT=y
CONFIG_NSH_BUILTIN_APPS=y
CONFIG_NSH_FILEIOSIZE=512
CONFIG_NSH_READLINE=y
CONFIG_SYSTEM_NSH=y
CONFIG_SYSTEM_SYSTEM=y
CONFIG_SYSTEM_PING=y
CONFIG_SYSTEM_YMODEM=y
CONFIG_SYSTEM_NBOOTCTL=y
CONFIG_EXAMPLES_K7FLASH=y

#
# File systems and storage
#
CONFIG_FS_PROCFS=y
CONFIG_FS_TMPFS=y
CONFIG_FS_BINFS=y
CONFIG_FS_FAT=y
CONFIG_FS_FATFS=y
CONFIG_FSUTILS_MKFATFS=y
CONFIG_FS_ROMFS=y
CONFIG_ETC_ROMFS=y
CONFIG_GPT_PARTITION=y
CONFIG_MBR_PARTITION=y
CONFIG_MMCSD_NSLOTS=2
CONFIG_RK3576_DDR_4G=y
CONFIG_RK3576_EMMC=y
CONFIG_RK3576_SDMMC=y
CONFIG_RK3576_SDIO=y
CONFIG_KICKPI_K7_STORAGE_AUTOMOUNT=y

#
# Chip peripherals
#
CONFIG_DEV_GPIO=y
CONFIG_RK3576_GPIO=y
CONFIG_RK3576_I2C=y
CONFIG_RK3576_DMA=y
CONFIG_RK3576_DMA_ALLOC=y
CONFIG_RK3576_TIMER=y
CONFIG_RK3576_TSADC=y
CONFIG_RK3576_PWM=y
CONFIG_RK3576_FSPI=y
CONFIG_SENSORS=y
CONFIG_ANALOG=y
CONFIG_ADC=y
CONFIG_RK3576_SARADC=y
CONFIG_KICKPI_K7_LITCORE_CPU_FREQ_SET=y
CONFIG_KICKPI_K7_WDT=y
CONFIG_RK3576_WDT=y
CONFIG_WATCHDOG_AUTOMONITOR=y
CONFIG_WATCHDOG_AUTOMONITOR_BY_WDOG=y
CONFIG_WATCHDOG_AUTOMONITOR_TIMEOUT=10
CONFIG_RTC=y
CONFIG_RTC_DATETIME=y
CONFIG_RTC_ALARM=y
CONFIG_RTC_EXTERNAL=y
CONFIG_RTC_DRIVER=y
CONFIG_RTC_ARCH=y
CONFIG_RTC_PCF8563=y
CONFIG_KICKPI_K7_RTC=y

#
# Crypto and random
#
CONFIG_CRYPTO=y
CONFIG_CRYPTO_MBEDTLS=y
CONFIG_CRYPTO_RANDOM_POOL=y
CONFIG_DEV_URANDOM=y

#
# Networking (SV6621 WiFi STA + SoftAP provisioning)
#
CONFIG_NET=y
CONFIG_NET_ARP=y
CONFIG_NET_BROADCAST=y
CONFIG_NETDEV_DEVPRIVATE_IOCTL=y
CONFIG_NET_ETH_PKTSIZE=1514
CONFIG_NET_ICMP_SOCKET=y
CONFIG_NET_IGMP=y
CONFIG_NET_IPv4=y
CONFIG_NET_IPv6=y
CONFIG_NET_LOOPBACK=y
CONFIG_NET_SOCKOPTS=y
CONFIG_NET_TCP=y
CONFIG_NET_UDP=y
CONFIG_NETDB_DNSCLIENT=y
CONFIG_NETUTILS_DHCPC=y
CONFIG_NETUTILS_DHCPD=y
CONFIG_NETUTILS_NETLIB=y
CONFIG_NETUTILS_WEBCLIENT=y
CONFIG_WIRELESS_WAPI=y
CONFIG_WIRELESS_WAPI_CMDTOOL=y
CONFIG_DRIVERS_IEEE80211=y
CONFIG_SV6621=y
CONFIG_SV6621_PM=y
CONFIG_KICKPI_K7_WIFI=y
CONFIG_LIBUV=y

#
# Bluetooth (SV6621 shared SDIO, ZBlue host)
#
CONFIG_KICKPI_K7_BLUETOOTH=y
CONFIG_UART_BTH4=y
CONFIG_UART_BTH4_TXBUFSIZE=2048
CONFIG_UART_BTH4_RXBUFSIZE=16384
CONFIG_UART_BTH4_NPOLLWAITERS=2
CONFIG_BT=y
CONFIG_BT_HCI=y
CONFIG_BT_HCI_HOST=y
CONFIG_BT_H4=y
CONFIG_BT_NATIVE=y
CONFIG_BT_UART_ON_DEV_NAME="/dev/ttyHCI0"
CONFIG_BT_PERIPHERAL=y
CONFIG_BT_CENTRAL=y
CONFIG_BT_BROADCASTER=y
CONFIG_BT_OBSERVER=y
CONFIG_BT_CONN=y
CONFIG_BT_MAX_CONN=2
CONFIG_BT_HCI_ACL_FLOW_CONTROL=y
CONFIG_BT_BUF_ACL_RX_SIZE=1025
CONFIG_BT_BUF_EVT_RX_SIZE=255
CONFIG_BT_BUF_CMD_TX_SIZE=255
CONFIG_BT_RX_STACK_SIZE=12288
CONFIG_BT_RECV_WORKQ_BT=y
CONFIG_BT_SMP=y
CONFIG_BT_BONDABLE=y
CONFIG_BT_PRIVACY=y
CONFIG_BT_SETTINGS=y
CONFIG_BT_GATT_CLIENT=y
CONFIG_BT_GATT_DYNAMIC_DB=y
CONFIG_BT_GATT_CACHING=y
CONFIG_BT_CLASSIC=y
CONFIG_BT_RFCOMM=y
CONFIG_BT_RFCOMM_L2CAP_MTU=1025
CONFIG_BT_A2DP=y
CONFIG_BT_AVRCP=y
CONFIG_BT_HFP_HF=y
CONFIG_BT_HFP_AG=y
CONFIG_BT_COD=0x6c0580
CONFIG_BT_ATT_PREPARE_COUNT=1

#
# Audio (SAI1 + ES8388 on the main domain; USB host audio)
#
CONFIG_AUDIO=y
CONFIG_DRIVERS_AUDIO=y
CONFIG_I2S=y
CONFIG_RK3576_SAI=y
CONFIG_KICKPI_K7_AUDIO=y
CONFIG_SYSTEM_AUDIOCTL=y
CONFIG_SYSTEM_NXPLAYER=y
CONFIG_SYSTEM_NXRECORDER=y

#
# USB host / device / ADB (kept on in product builds)
#
CONFIG_RK3576_USB=y
CONFIG_RK3576_USBHOST=y
CONFIG_KICKPI_K7_USBHOST=y
CONFIG_USBHOST_AUDIO=y
CONFIG_USBHOST_MSC_NOTIFIER=y
CONFIG_USBHOST_WAITER_PRIO=50
CONFIG_USBDEV=y
CONFIG_USBDEV_DUALSPEED=y
CONFIG_USBDEV_DMA=y
CONFIG_CDCACM=y
CONFIG_SYSTEM_CDCACM=y
CONFIG_USBADB=y
CONFIG_SYSTEM_ADBD=y
CONFIG_ADBD_USB_SERVER=y
CONFIG_ADBD_USB_BOARDCTL=y
CONFIG_ADBD_FILE_SERVICE=y
CONFIG_ADBD_SHELL_SERVICE=y
CONFIG_USBADB_SERIALSTR="RK3576"
CONFIG_USBADB_PRODUCTSTR="Nyabula KICKPI-K7"
CONFIG_ADBD_PRODUCT_NAME="Nyabula"
CONFIG_ADBD_PRODUCT_MODEL="KICKPI-K7"
CONFIG_ADBD_PRODUCT_DEVICE="kickpi-k7"
CONFIG_ADBD_PAYLOAD_SIZE=32768
CONFIG_ADBD_CNXN_PAYLOAD_SIZE=32768
CONFIG_ADBD_FRAME_MAX=4

#
# Dual round LCD + LVGL + Eye Engine
#
CONFIG_LCD=y
CONFIG_LCD_DEV=y
CONFIG_NYABULA_CUSTOM_DRIVERS=y
CONFIG_LCD_ST77916=y
CONFIG_LCD_ST77916_CHIP_TYPE_GC9B72=y
CONFIG_KICKPI_K7_LCD=y
CONFIG_GRAPHICS_LVGL=y
CONFIG_LV_USE_NUTTX=y
CONFIG_LV_COLOR_DEPTH_16=y
CONFIG_LV_USE_CLIB_MALLOC=y
CONFIG_LV_USE_CLIB_STRING=y
CONFIG_LV_USE_CLIB_SPRINTF=y
CONFIG_LV_GRADIENT_MAX_STOPS=8
CONFIG_LV_USE_LOG=y
CONFIG_LV_LOG_LEVEL_USER=y
CONFIG_GRAPHICS_NYABULA_DISPLAY=y
CONFIG_NYABULA_DISPLAY_TE_BOARDCTL=y
CONFIG_NYABULA_EYE_ENGINE=y
CONFIG_NYABULA_EYE_DISPLAY=y

#
# Nyabula Core: plugin runtime, product services, Nyabot, Web
#
CONFIG_CONTEST2026_062_NYABULA_CORE=y
CONFIG_NYABULA_CORE_EYE=y
CONFIG_NYABULA_CORE_WAMR=y
CONFIG_INTERPRETERS_QUICKJS_NONE=y
CONFIG_INTERPRETERS_WAMR_CLASSIC=y
CONFIG_INTERPRETERS_WAMR_BULK_MEMORY=y
CONFIG_NYABULA_CORE_STATE_SQLITE=y
CONFIG_NYABULA_CORE_STATE_DATABASE="/data/nyabula/core.sqlite"
CONFIG_NYABULA_CORE_PRODUCT=y
CONFIG_NYABULA_CORE_MEDIA=y
CONFIG_NYABULA_CORE_MEDIA_ROOT="/data/music"
CONFIG_NYABULA_CORE_MEDIA_DEVICE="/dev/audio/pcm0"
CONFIG_NYABULA_CORE_WEB=y
CONFIG_NYABULA_CORE_HTTP=y
CONFIG_NYABULA_CORE_AGENT=y
CONFIG_NYABULA_CORE_WEATHER=y
CONFIG_NYABULA_CORE_GRANT_STORE="/data/nyabula/grants.json"
CONFIG_NYABULA_CORE_PACKAGE_STORE="/data/nyabula/apps"
CONFIG_NYABULA_CORE_HEALTH_STORE="/data/nyabula/health"
CONFIG_NYABULA_CORE_REVOCATION_STORE="/data/nyabula/revocations.json"
CONFIG_NYABULA_CORE_TRUST_STORE="/data/nyabula/trusted-keys.json"
CONFIG_EXAMPLES_AI_AGENT_VELA=y
CONFIG_EXAMPLES_AI_AGENT_VELA_DATA_DIR="/data/agent"
CONFIG_AI_AGENT_MCP=y

#
# AMP compute domain link (Linux on A72 via RPMsg)
#
CONFIG_RK3576_MAILBOX=y
CONFIG_RK3576_RPTUN=y
CONFIG_RPMSG_CHAR=y
CONFIG_OPENAMP_CACHE=y
CONFIG_EXAMPLES_NYAMPCTL=y
```

## drivers/drivers/Kconfig
```kconfig
# drivers/drivers/Kconfig
#
# SPDX-License-Identifier: Apache-2.0

config NYABULA_CUSTOM_DRIVERS
    bool "Nyabula Custom Drivers"
	default y
    select SPECIFIC_DRIVERS

if NYABULA_CUSTOM_DRIVERS

source "$BINDIR/drivers/platform/drivers/st77916/Kconfig"
source "$BINDIR/drivers/platform/drivers/pcf8563/Kconfig"
source "$BINDIR/drivers/platform/drivers/sv6621/Kconfig"
source "$BINDIR/drivers/platform/drivers/gt911/Kconfig"
source "$BINDIR/drivers/platform/drivers/ov5647/Kconfig"

endif
```
