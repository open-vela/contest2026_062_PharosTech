## drivers/drivers/gt911/Kconfig
```kconfig
#
# For a description of the syntax of this configuration file,
# see the file kconfig-language.txt in the NuttX tools repository.
#

config INPUT_GT911
    bool "Goodix GT911 touch controller"
    default n
    depends on I2C
    select INPUT_TOUCHSCREEN
    ---help---
        Enable the Goodix GT911 (and GT9-family compatible) capacitive touch
        controller driver.

        The driver is a lower half of the generic NuttX touchscreen framework
        (CONFIG_INPUT_TOUCHSCREEN, /dev/inputN), so it can be consumed by
        LVGL through CONFIG_LV_USE_NUTTX_TOUCHSCREEN or read directly.  It
        reports every contact in the controller's frame (up to
        INPUT_GT911_MAX_POINTS) with the track id the controller assigns.

        Nothing that belongs to a specific module is compiled into the driver:
        the reset and interrupt lines come in through struct gt911_board_s,
        the configuration table for a module that arrived without one comes in
        through struct gt911_config_s, and the coordinate orientation -- how
        the module is mounted relative to the framebuffer, which is a property
        of the product rather than of the chip -- is passed to
        gt911_register().  That keeps one driver usable by several boards
        whose panels are mounted differently, and lets a board derive the
        touch orientation and the display orientation from one setting so the
        two cannot disagree.

        See boards/rk3576/drivers/include/gt911.h for all three.

if INPUT_GT911

config INPUT_GT911_I2C_FREQUENCY
    int "I2C frequency (Hz)"
    default 400000
    range 0 400000
    ---help---
        I2C bus frequency used to talk to the controller.  400 kHz is the
        controller's maximum and needs adequate external pull-ups on SCL/SDA;
        drop to 100000 if the bus wiring is long or the pull-ups are weak.

config INPUT_GT911_MAX_POINTS
    int "Number of touch points reported per sample"
    default 5
    range 1 10
    ---help---
        Number of contact slots in every sample the driver publishes.  This
        value is what the framework reports through TSIOC_GETMAXPOINTS and it
        sizes every sample, so LVGL reads exactly this many points per
        read().

        The GT911 supports up to 5 contacts, but the module's configuration
        may cap it lower; slots with no contact are reported with no flags.
        LVGL uses only the first point unless gesture recognition is enabled.
        Slots beyond the controller's own maximum are simply never used.

config INPUT_GT911_SAMPLE_CACHES
    int "Number of samples buffered by the framework"
    default 4
    range 1 16
    ---help---
        Depth of the touchscreen framework's sample queue.  A deeper queue
        keeps fast bursts of samples from overwriting each other when the
        reader (LVGL) is slower than the controller's scan rate.

config INPUT_GT911_POLL_MS
    int "Fallback polling interval (ms)"
    default 20
    range 0 1000
    ---help---
        The controller raises INT once per scan period while a read frame is
        waiting; with the INT line wired, the interrupt path does the work and
        this poll is only a safety net that repairs a missed edge.

        Set it to 0 for pure interrupt-driven operation (a board without a
        poll still needs the INT line), or to a few tens of milliseconds to
        run interrupt-free.  Interrupts, when wired, always take priority over
        this interval.

config INPUT_GT911_CONFIG_FORCE
    bool "Overwrite the module configuration even if it is already valid"
    default n
    ---help---
        The driver only writes the board's configuration table when the
        controller reports no usable configuration: a module that already
        carries one -- programmed at the factory, or by the vendor's own
        driver -- is left alone, because sensing parameters are a property of
        the touch sensor and a wrong guess senses poorly or not at all.

        Enable this to force a rewrite, which is what trying a different
        table on a module that has already been programmed needs.  Note that
        the controller keeps one configuration: a forced write replaces
        whatever is in there.

        This is a bring-up option, not something a product should ship with
        unless its own table is known to be correct.

endif # INPUT_GT911
```

## drivers/drivers/ov5647/Kconfig
```kconfig
############################################################################
# drivers/drivers/ov5647/Kconfig
#
# SPDX-License-Identifier: Apache-2.0
#
# Licensed to the Apache Software Foundation (ASF) under one or more
# contributor license agreements.  See the NOTICE file distributed with
# this work for additional information regarding copyright ownership.  The
# ASF licenses this file to you under the Apache License, Version 2.0 (the
# "License"); you may not use this file except in compliance with the
# License.  You may obtain a copy of the License at
#
#   http://www.apache.org/licenses/LICENSE-2.0
#
# Unless required by applicable law or agreed to in writing, software
# distributed under the License is distributed on an "AS IS" BASIS, WITHOUT
# WARRANTIES OR CONDITIONS OF ANY KIND, either express or implied.  See the
# License for the specific language governing permissions and limitations
# under the License.
#
############################################################################
#
# OmniVision OV5647 MIPI CSI-2 camera sensor driver.
#
############################################################################

config VIDEO_OV5647
	bool "OV5647 camera sensor"
	default n
	depends on DRIVERS_VIDEO
	select I2C
	---help---
		Enable the OmniVision OV5647 MIPI CSI-2 camera sensor driver.

		The driver implements the NuttX capture framework's sensor side
		(struct imgsensor_s), so the board registers it together with a
		SoC-side imgdata driver:

		  ov5647_initialize(i2c, OV5647_I2C_ADDR);
		  capture_register("/dev/video0", imgdata, sensors, 1);

		The sensor outputs RAW10 Bayer data over two MIPI CSI-2 data
		lanes.  Its control interface is SCCB, which is an I2C subset the
		standard NuttX I2C driver drives directly.

		Seven modes are implemented, in four geometries, and the
		application chooses one for each stream it opens.  The board
		reconfigures its VICAP/CSI path to match; see the board's
		KICKPI_K7 camera source.

		  1920x1080 @ 15   the middle of the array, read at full
		                   resolution and cropped
		  1296x960 @ 30    the 2x2 bin of the whole array
		  1296x960 @ 15
		  1280x720 @ 30    that binned readout, cropped to 16:9
		  1280x720 @ 15
		  640x480  @ 60    the binned array, subsampled
		  640x480  @ 30

		Each geometry runs at two rates, and the slower entry of a pair is
		the one that can expose a darker scene: the frame is longer, and an
		exposure cannot outlast the frame it is in.  A pair differs in
		nothing else -- the two entries share a register set and a link
		rate -- so moving between them costs no clock, no D-PHY rate and no
		buffers.  Reaching the slower rate of the three faster geometries
		does need a longer line as well as a longer frame, because their
		vertical total is eleven bits and caps a frame at 2047 lines.

		The 1920x1080 mode is the one that reads the middle of the pixel
		array at full resolution, with no binning.  It therefore collects
		less light per pixel than the binned modes do -- about 0.9 of a stop
		less than 1296x960, after taking the longest exposure its 15 fps
		readout allows -- and it shows less of the scene, because it crops.
		What it gives in exchange is 1.67 times the pixels in a 16:9 shape.
		It is also the only geometry that changes the capture geometry
		without changing the MIPI link rate.

		The 1280x720 mode changes the geometry without changing the link
		rate either, but it gets there the other way: it keeps the binned
		readout and crops it to 16:9.  That costs a quarter of the vertical
		field of view and no light at all, and it cuts the pixels every
		stage behind the sensor has to move to 74 per cent -- which is what
		it is for, since the 1296x960 modes were measured running slightly
		over their own frame period.  It is also the geometry the encoder
		needs no padding or cropping for.

		None of that is configurable here, and one part of it is worth
		saying why.  The driver has to name a mode for the sensor to sit in
		before an application has asked for anything -- a capture device
		has to exist before it can be asked for a format, and the engine
		behind this sensor has no scaler, so a device node implies a
		geometry.  That mode is OV5647_MODE_DEFAULT in ov5647.h, and it is
		not a Kconfig setting because it is not a decision: the table's
		first entry, for the reason its comment gives.  Which mode a stream
		runs at is the application's to choose, and it says so before it
		opens the camera.
if VIDEO_OV5647

config OV5647_I2C_ADDR
	hex "OV5647 I2C (SCCB) slave address"
	default 0x36
	range 0x08 0x77
	depends on VIDEO_OV5647
	---help---
		Seven-bit SCCB address.  The OV5647's factory default is 0x36,
		which is what a Raspberry Pi compatible module uses.

config OV5647_I2C_FREQUENCY
	int "OV5647 I2C (SCCB) bus frequency"
	default 100000
	depends on VIDEO_OV5647
	---help---
		SCCB is specified for 100 kHz.  The sensor tolerates more on most
		modules, but the specification has no acknowledgement bit, so a
		faster clock leaves less margin for the receiver to sample it
		reliably.

endif # VIDEO_OV5647
```

## drivers/drivers/sv6621/Kconfig
```kconfig
# drivers/drivers/sv6621/Kconfig
#
# SPDX-License-Identifier: Apache-2.0

config SV6621
	bool "SeekWave SV6621 WiFi/BT SDIO"
	default n
	depends on NET
	select CRYPTO
	select CRYPTO_MBEDTLS
	select MBEDTLS_CMAC_C
	select CRYPTO_RANDOM_POOL
	select DEV_URANDOM
	select DRIVERS_WIRELESS
	select NETDEV_WIRELESS_IOCTL
	select SCHED_HPWORK
	select SCHED_LPWORK
	---help---
		Enable the transport-independent firmware loader, FullMAC control
		protocol, WPA2-PSK/WPA3-SAE authentication and NuttX network
		interface for the SeekWave SV6621/SWT6621-S combo.  A platform
		transport adapter must also be selected.

config SV6621_PM
	bool "SeekWave SV6621 system power management"
	default n
	depends on SV6621 && PM
	---help---
		Register the SV6621 core with the NuttX power manager.  System sleep
		uses the wake policy supplied by the board configuration.  A platform
		coordinator must suspend the firmware from thread context before deep
		sleep; the PM callback only checks readiness and schedules resume work.

config SV6621_BLUETOOTH
	bool "SeekWave SV6621 Bluetooth HCI over SDIO"
	default n
	depends on SV6621
	select DRIVERS_BLUETOOTH
	select UART_BTH4
	---help---
		Expose the Bluetooth controller inside the SV6621 combo through the
		NuttX H4 pseudo-UART device.  Bluetooth HCI command/event, ACL and ISO
		traffic uses SDIO virtual channels shared with the Wi-Fi transport.

config SV6621_RXPRIO
	int "SeekWave receive thread priority"
	default 100
	depends on SV6621

config SV6621_RXSTACK
	int "SeekWave receive thread stack size"
	default 4096
	depends on SV6621

config SV6621_RECOVERY_PRIO
	int "SeekWave recovery thread priority"
	default 90
	depends on SV6621

config SV6621_RECOVERY_STACK
	int "SeekWave recovery thread stack size"
	default 6144
	depends on SV6621
```

## drivers/drivers/ws2812/Kconfig
```kconfig
#
# For a description of the syntax of this configuration file,
# see the file kconfig-language.txt in the NuttX tools repository.
#

config WS2812_CHARDEV
    bool "WS2812 addressable LED character driver (SPI)"
    default n
    depends on SPI
    ---help---
        Register WS2812-family strips that are driven over SPI as
        character devices.  One WS2812 bit is encoded as one SPI byte, so
        the SPI clock must be eight times the strip's bit rate.

        Unlike the in-tree CONFIG_WS2812 driver, this one keeps no pixel
        shadow buffer and holds no permanent claim on the SPI bus.  Each
        write() carries a complete frame and is transmitted immediately;
        nothing is carried over between calls and lseek() is rejected.
        The bus is locked only for the duration of one frame, and an
        optional select callback runs around each frame, so several strips
        can share one SPI controller through an external multiplexer and
        take turns on it.

        Do not enable CONFIG_WS2812 (the in-tree driver) for the same SPI
        bus: it locks the bus permanently at registration time.

if WS2812_CHARDEV

config WS2812_CHARDEV_FREQUENCY
    int "Requested SPI clock frequency (Hz)"
    default 6400000
    ---help---
        SPI clock to request, not the strip's bit rate (one WS2812 bit is
        one SPI byte, so the clock is eight times the bit rate).  6.4 MHz
        targets the common 800 kHz parts at 1.25 us per bit.

        The SPI lower-half may not be able to hit the request exactly, and
        the rate it reports back can disagree with the SCLK the controller
        actually generates.  The driver therefore measures the real byte
        rate at registration (about 90 ms of idle low) and derives the 0/1
        high times from that measurement.  Any measured clock in 3.6-9.0
        MHz is accepted; outside that range write() fails with -EIO.

config WS2812_CHARDEV_MAX_PIXELS
    int "Maximum pixels per write"
    default 1024
    range 1 65535
    ---help---
        Largest frame the driver accepts in one write(); the transmit
        scratch buffer is sized from it.  A write carrying more pixels
        fails with -EFBIG.

endif # WS2812_CHARDEV
```
